## CMakeLists.txt
```
# SPDX-License-Identifier: MIT

cmake_minimum_required(VERSION 3.20.0)
include(${CMAKE_CURRENT_SOURCE_DIR}/../common/defy_test.cmake)
option(DEFY_TEST_GRACEFUL_SLEEP "Stopping Bluetooth before the half sleeps, in src/graceful_main.c" OFF)
set(DTC_OVERLAY_FILE ${DEFY_ROOT}/tests/drivers/common/cable_peripheral.overlay)
find_package(Zephyr REQUIRED HINTS $ENV{ZEPHYR_BASE})
project(defy_hybrid_peripheral_test)

target_include_directories(app PRIVATE ${DEFY_ZMK_APP}/include ${DEFY_ROOT}/drivers/split)
if(DEFY_TEST_GRACEFUL_SLEEP)
  target_sources(app PRIVATE src/graceful_main.c src/fake_links.c)
  target_compile_definitions(app PRIVATE CONFIG_DEFY_HALF_SLEEP=1 CONFIG_BT_MAX_CONN=1)
else()
  target_sources(app PRIVATE src/main.c src/fake_links.c)
  # The half's LEDs, for the connection state that the hybrid passes to
  # defy_startup_split_connected(), which src/main.c defines and counts.
  # The graceful build leaves them out, as a hybrid half may.
  target_compile_definitions(app PRIVATE CONFIG_DEFY_HALF_LEDS=1)
endif()
zephyr_linker_sources(SECTIONS ${DEFY_ZMK_APP}/include/linker/zmk-split-transport-peripheral.ld)
```

## Kconfig
```
# SPDX-License-Identifier: MIT

mainmenu "Defy hybrid peripheral tests"

config ZMK_SPLIT
    bool
    default y

config ZMK_SPLIT_ROLE_CENTRAL
    bool
    default n

config ZMK_SPLIT_BLE
    bool
    default y

config ZMK_SPLIT_BLE_PRIORITY
    int
    default 20

config ZMK_LOG_LEVEL
    int
    default 3

source "Kconfig.zephyr"
```

## prj.conf
```kconfig
# SPDX-License-Identifier: MIT

CONFIG_ZTEST=y
CONFIG_SPI=y
CONFIG_GPIO=y
CONFIG_LOG=y
CONFIG_ASSERT=y
CONFIG_DEFY_WIRED=y
CONFIG_DEFY_HYBRID=y
CONFIG_DEFY_WIRED_PRIORITY=10
CONFIG_SYS_CLOCK_TICKS_PER_SEC=10000
CONFIG_DEFY_HYBRID_IDLE_TIMEOUT_MS=500
```

## src/fake_links.c
```c
/* SPDX-License-Identifier: MIT */

#include <errno.h>
#include <string.h>

#include <zephyr/drivers/spi.h>
#include <zephyr/init.h>
#include <zephyr/kernel.h>
#include <zephyr/sys/atomic.h>
#include <zephyr/ztest.h>

#include <zmk/events/split_peripheral_status_changed.h>
#include <zmk/split/transport/peripheral.h>
#include <dygma/defy_split_peripheral.h>
#include <dygma/defy_wired_protocol.h>

#include "fake_links.h"

static K_MUTEX_DEFINE(lock);
static atomic_t reports_active;
static atomic_t pause_transfer;
static bool pause_requires_ack;
static K_SEM_DEFINE(transfer_paused, 0, 1);
static K_SEM_DEFINE(transfer_resume, 0, 1);
static struct defy_wired_rx receiver;
static uint8_t reply[DEFY_WIRED_FRAME_SIZE];
static struct fake_link_snapshot data;
static bool cable_online;
static bool bluetooth_available;
static bool bluetooth_connected;
static bool slow_reports;
#if IS_ENABLED(CONFIG_DEFY_HALF_SLEEP)
static bool delayed_disconnect;
static bool conn_present;
static enum bt_conn_state conn_state;
static bool advertising_allowed = true;
static int adv_stop_error;
static unsigned int adv_stop_calls;
static atomic_t conn_refs;
static atomic_t stop_paused;
static K_SEM_DEFINE(stop_started, 0, 1);
static K_SEM_DEFINE(stop_resume, 0, 1);
static int fake_conn;
struct k_work_q service_work_q;
static K_THREAD_STACK_DEFINE(service_stack, 2048);

static void advertising_handler(struct k_work *work) { ARG_UNUSED(work); }
K_WORK_DEFINE(advertising_work, advertising_handler);

static int init_service_queue(void) {
    k_work_queue_start(&service_work_q, service_stack, K_THREAD_STACK_SIZEOF(service_stack),
                       5, NULL);
    return 0;
}
SYS_INIT(init_service_queue, APPLICATION, 50);

void defy_bt_identity_set_advertising(bool allowed) {
    k_mutex_lock(&lock, K_FOREVER);
    advertising_allowed = allowed;
    k_mutex_unlock(&lock);
}

struct bt_conn *bt_conn_ref(struct bt_conn *conn) {
    zassert_equal(conn, (struct bt_conn *)&fake_conn);
    atomic_inc(&conn_refs);
    return conn;
}

void bt_conn_unref(struct bt_conn *conn) {
    zassert_equal(conn, (struct bt_conn *)&fake_conn);
    zassert_true(atomic_dec(&conn_refs) > 0);
}

void bt_conn_foreach(enum bt_conn_type type, void (*func)(struct bt_conn *, void *), void *data) {
    zassert_equal(type, BT_CONN_TYPE_LE);
    k_mutex_lock(&lock, K_FOREVER);
    bool present = conn_present;
    k_mutex_unlock(&lock);
    if (present) {
        func((struct bt_conn *)&fake_conn, data);
    }
}

int bt_conn_get_info(const struct bt_conn *conn, struct bt_conn_info *info) {
    zassert_equal(conn, (struct bt_conn *)&fake_conn);
    k_mutex_lock(&lock, K_FOREVER);
    *info = (struct bt_conn_info){.state = conn_state};
    k_mutex_unlock(&lock);
    return 0;
}

int bt_le_adv_stop(void) {
    zassert_equal(k_current_get(), &service_work_q.thread);
    k_mutex_lock(&lock, K_FOREVER);
    zassert_false(advertising_allowed);
    adv_stop_calls++;
    int err = adv_stop_error;
    k_mutex_unlock(&lock);
    if (atomic_cas(&stop_paused, 1, 0)) {
        k_sem_give(&stop_started);
        k_sem_take(&stop_resume, K_FOREVER);
    }
    return err;
}
#endif
static zmk_split_transport_peripheral_status_changed_cb_t status_callback;

static int transfer(const struct device *dev, const struct spi_config *config,
                    const struct spi_buf_set *tx, const struct spi_buf_set *rx) {
    ARG_UNUSED(dev);
    ARG_UNUSED(config);
    zassert_equal(tx->count, 1);
    zassert_equal(rx->count, 1);
    zassert_equal(tx->buffers[0].len, DEFY_WIRED_FRAME_SIZE);
    zassert_equal(rx->buffers[0].len, DEFY_WIRED_FRAME_SIZE);
    k_mutex_lock(&lock, K_FOREVER);
    data.cable_exchanges++;
    memset(rx->buffers[0].buf, 0xff, DEFY_WIRED_FRAME_SIZE);
    if (cable_online) {
        memcpy(rx->buffers[0].buf, reply, DEFY_WIRED_FRAME_SIZE);
        struct defy_wired_packet packet;
        struct defy_wired_packet ack;

        zassert_ok(defy_wired_decode(tx->buffers[0].buf, DEFY_WIRED_FRAME_SIZE, &packet));
        int result = defy_wired_rx_accept(&receiver, &packet, &ack);

        zassert_true(result >= 0);
        if (result == DEFY_WIRED_UPDATED) {
            memcpy(data.cable_keys, packet.bitmap, sizeof(data.cable_keys));
            data.cable_updates++;
        }
        defy_wired_encode(&ack, reply);
    }
    k_mutex_unlock(&lock);
    if (atomic_get(&pause_transfer)) {
        struct defy_wired_packet response;
        bool valid_ack = defy_wired_decode(rx->buffers[0].buf, DEFY_WIRED_FRAME_SIZE,
                                          &response) == 0;

        if ((!pause_requires_ack || valid_ack) && atomic_cas(&pause_transfer, 1, 0)) {
            k_sem_give(&transfer_paused);
            k_sem_take(&transfer_resume, K_FOREVER);
        }
    }
    return 0;
}

static DEVICE_API(spi, spi_api) = {.transceive = transfer};
SPI_DEVICE_DT_DEFINE(DT_NODELABEL(spi0), NULL, NULL, NULL, NULL, POST_KERNEL,
                     CONFIG_SPI_INIT_PRIORITY, &spi_api);

static struct zmk_split_transport_status get_status(void) {
    k_mutex_lock(&lock, K_FOREVER);
    data.bluetooth_status_reads++;
    struct zmk_split_transport_status status = {
        .available = bluetooth_available,
        .enabled = data.bluetooth_enabled,
        .connections = bluetooth_connected ? ZMK_SPLIT_TRANSPORT_CONNECTIONS_STATUS_ALL_CONNECTED
                                            : ZMK_SPLIT_TRANSPORT_CONNECTIONS_STATUS_DISCONNECTED,
    };

    k_mutex_unlock(&lock);
    return status;
}

static int set_enabled(bool enabled) {
    k_mutex_lock(&lock, K_FOREVER);
    data.bluetooth_enabled = enabled;
    data.bluetooth_enable_calls++;
    bool disconnected = !enabled && bluetooth_connected;

    if (!enabled) {
#if IS_ENABLED(CONFIG_DEFY_HALF_SLEEP)
        if (!delayed_disconnect) {
            bluetooth_connected = false;
            conn_present = false;
            conn_state = BT_CONN_STATE_DISCONNECTED;
        }
#else
        bluetooth_connected = false;
#endif
    }
    k_mutex_unlock(&lock);
    if (disconnected) {
        raise_zmk_split_peripheral_status_changed(
            (struct zmk_split_peripheral_status_changed){.connected = false});
    }
    return 0;
}

static int set_status_callback(zmk_split_transport_peripheral_status_changed_cb_t callback) {
    status_callback = callback;
    return 0;
}

static void begin_report(void) {
    bool overlapping = atomic_inc(&reports_active) != 0;

    k_mutex_lock(&lock, K_FOREVER);
    if (overlapping) {
        data.concurrent_reports++;
    }
    bool slow = slow_reports;

    k_mutex_unlock(&lock);
    if (slow) {
        k_sleep(K_MSEC(2));
    }
}

static void notify_snapshot(void) {
    if (bluetooth_connected) {
        int64_t now = k_uptime_get();

        if (data.snapshots > 0) {
            int64_t gap = now - data.last_snapshot_ms;

            data.min_snapshot_gap_ms = MIN(data.min_snapshot_gap_ms, gap);
            data.max_snapshot_gap_ms = MAX(data.max_snapshot_gap_ms, gap);
        }
        data.last_snapshot_ms = now;
        data.snapshots++;
        memcpy(data.notified_keys, data.bluetooth_keys, sizeof(data.notified_keys));
    }
}

int send_position_state(void) {
    begin_report();
    k_mutex_lock(&lock, K_FOREVER);
    notify_snapshot();
    k_mutex_unlock(&lock);
    atomic_dec(&reports_active);
    return 0;
}

static int report_event(const struct zmk_split_transport_peripheral_event *event) {
    if (event->type != ZMK_SPLIT_TRANSPORT_PERIPHERAL_EVENT_TYPE_KEY_POSITION_EVENT) {
        return -ENOTSUP;
    }
    uint8_t position = event->data.key_position_event.position;

    zassert_true(position < 128);
    begin_report();
    k_mutex_lock(&lock, K_FOREVER);
    WRITE_BIT(data.bluetooth_keys[position / 8], position % 8,
              event->data.key_position_event.pressed != 0);
    data.bluetooth_reports++;
    notify_snapshot();
    k_mutex_unlock(&lock);
    atomic_dec(&reports_active);
    return 0;
}

static const struct zmk_split_transport_peripheral_api api = {
    .report_event = report_event,
    .set_enabled = set_enabled,
    .get_status = get_status,
    .set_status_callback = set_status_callback,
};

ZMK_SPLIT_TRANSPORT_PERIPHERAL_REGISTER(fake_bt, &api, CONFIG_ZMK_SPLIT_BLE_PRIORITY);

struct zmk_split_transport_peripheral *zmk_split_transport_peripheral_bt(void) {
    return &fake_bt;
}

const struct zmk_event_type zmk_event_zmk_split_peripheral_status_changed;
extern const struct zmk_listener zmk_listener_defy_hybrid_peripheral;

/* ZMK's event manager, for the hybrid's listener alone. */
int raise_zmk_split_peripheral_status_changed(struct zmk_split_peripheral_status_changed status) {
    struct zmk_split_peripheral_status_changed_event event = {
        .header = {.event = &zmk_event_zmk_split_peripheral_status_changed},
        .data = status,
    };

    k_mutex_lock(&lock, K_FOREVER);
    if (status.connected) {
        data.zmk_connected_events++;
    } else {
        data.zmk_disconnected_events++;
    }
    k_mutex_unlock(&lock);
    return zmk_listener_defy_hybrid_peripheral.callback(&event.header);
}

void fake_links_reset(void) {
    k_mutex_lock(&lock, K_FOREVER);
    memset(&data, 0, sizeof(data));
    data.min_snapshot_gap_ms = INT64_MAX;
    memset(reply, 0, sizeof(reply));
    defy_wired_rx_init(&receiver);
    cable_online = false;
    bluetooth_available = false;
    bluetooth_connected = false;
    slow_reports = false;
#if IS_ENABLED(CONFIG_DEFY_HALF_SLEEP)
    delayed_disconnect = false;
    conn_present = false;
    conn_state = BT_CONN_STATE_DISCONNECTED;
    advertising_allowed = true;
    adv_stop_error = 0;
    adv_stop_calls = 0;
    zassert_equal(atomic_get(&conn_refs), 0);
    atomic_clear(&stop_paused);
    k_sem_reset(&stop_started);
    k_sem_reset(&stop_resume);
#endif
    atomic_clear(&reports_active);
    atomic_clear(&pause_transfer);
    k_sem_reset(&transfer_paused);
    k_sem_reset(&transfer_resume);
    k_mutex_unlock(&lock);
}

void fake_cable_online(bool value) {
    k_mutex_lock(&lock, K_FOREVER);
    cable_online = value;
    k_mutex_unlock(&lock);
}

void fake_cable_pause_transfer(bool require_ack) {
    pause_requires_ack = require_ack;
    k_sem_reset(&transfer_paused);
    k_sem_reset(&transfer_resume);
    atomic_set(&pause_transfer, 1);
}

int fake_cable_await_pause(void) { return k_sem_take(&transfer_paused, K_MSEC(350)); }

void fake_cable_resume_transfer(void) { k_sem_give(&transfer_resume); }

void fake_bluetooth_available(bool value) {
    k_mutex_lock(&lock, K_FOREVER);
    bluetooth_available = value;
    k_mutex_unlock(&lock);
    if (status_callback != NULL) {
        status_callback(&fake_bt, get_status());
    }
}

void fake_bluetooth_connected(bool value) {
    k_mutex_lock(&lock, K_FOREVER);
    bluetooth_connected = value;
#if IS_ENABLED(CONFIG_DEFY_HALF_SLEEP)
    conn_present = value;
    conn_state = value ? BT_CONN_STATE_CONNECTED : BT_CONN_STATE_DISCONNECTED;
#endif
    k_mutex_unlock(&lock);
    raise_zmk_split_peripheral_status_changed(
        (struct zmk_split_peripheral_status_changed){.connected = value});
}

void fake_bluetooth_slow_reports(bool value) {
    k_mutex_lock(&lock, K_FOREVER);
    slow_reports = value;
    k_mutex_unlock(&lock);
}

void fake_bluetooth_reset_gaps(void) {
    k_mutex_lock(&lock, K_FOREVER);
    data.min_snapshot_gap_ms = INT64_MAX;
    data.max_snapshot_gap_ms = 0;
    k_mutex_unlock(&lock);
}

struct fake_link_snapshot fake_links_snapshot(void) {
    k_mutex_lock(&lock, K_FOREVER);
    struct fake_link_snapshot snapshot = data;

    k_mutex_unlock(&lock);
    return snapshot;
}

#if IS_ENABLED(CONFIG_DEFY_HALF_SLEEP)
void fake_bluetooth_delay_disconnect(bool value) {
    k_mutex_lock(&lock, K_FOREVER);
    delayed_disconnect = value;
    k_mutex_unlock(&lock);
}

void fake_bluetooth_state(enum bt_conn_state state) {
    k_mutex_lock(&lock, K_FOREVER);
    conn_present = true;
    conn_state = state;
    k_mutex_unlock(&lock);
}

void fake_bluetooth_pause_stop(void) {
    k_sem_reset(&stop_started);
    k_sem_reset(&stop_resume);
    atomic_set(&stop_paused, 1);
}
int fake_bluetooth_await_stop(void) { return k_sem_take(&stop_started, K_MSEC(350)); }
void fake_bluetooth_resume_stop(void) { k_sem_give(&stop_resume); }
void fake_bluetooth_stop_error(int error) { adv_stop_error = error; }
bool fake_bluetooth_advertising_allowed(void) { return advertising_allowed; }
unsigned int fake_bluetooth_stop_calls(void) { return adv_stop_calls; }
int fake_bluetooth_ref_count(void) { return atomic_get(&conn_refs); }
#endif
```

## src/fake_links.h
```c
/* SPDX-License-Identifier: MIT */

#ifndef DEFY_HYBRID_TEST_LINKS_H
#define DEFY_HYBRID_TEST_LINKS_H

#include <stdbool.h>
#include <stddef.h>
#include <stdint.h>

struct fake_link_snapshot {
    uint8_t cable_keys[9];
    uint8_t bluetooth_keys[16];
    uint8_t notified_keys[16];
    size_t cable_exchanges;
    size_t cable_updates;
    size_t bluetooth_reports;
    size_t snapshots;
    size_t concurrent_reports;
    unsigned int bluetooth_enable_calls;
    unsigned int bluetooth_status_reads;
    unsigned int zmk_connected_events;
    unsigned int zmk_disconnected_events;
    int64_t last_snapshot_ms;
    int64_t min_snapshot_gap_ms;
    int64_t max_snapshot_gap_ms;
    bool bluetooth_enabled;
};

void fake_links_reset(void);
void fake_cable_online(bool value);
void fake_cable_pause_transfer(bool require_ack);
int fake_cable_await_pause(void);
void fake_cable_resume_transfer(void);
void fake_bluetooth_available(bool value);
void fake_bluetooth_connected(bool value);
void fake_bluetooth_slow_reports(bool value);
void fake_bluetooth_reset_gaps(void);
struct fake_link_snapshot fake_links_snapshot(void);

#if IS_ENABLED(CONFIG_DEFY_HALF_SLEEP)
#include <zephyr/bluetooth/conn.h>
void fake_bluetooth_delay_disconnect(bool value);
void fake_bluetooth_state(enum bt_conn_state state);
void fake_bluetooth_pause_stop(void);
int fake_bluetooth_await_stop(void);
void fake_bluetooth_resume_stop(void);
void fake_bluetooth_stop_error(int error);
bool fake_bluetooth_advertising_allowed(void);
unsigned int fake_bluetooth_stop_calls(void);
int fake_bluetooth_ref_count(void);
#endif

#endif
```

## src/graceful_main.c
```c
/* SPDX-License-Identifier: MIT */

#include <errno.h>

#include <zephyr/kernel.h>
#include <zephyr/ztest.h>
#include <zmk/split/transport/peripheral.h>
#include <dygma/defy_hybrid.h>
#include <dygma/defy_split_peripheral.h>
#include <dygma/defy_wired_protocol.h>

#include "defy_split_internal.h"
#include "fake_links.h"

static int key_event(bool pressed) {
    struct zmk_split_transport_peripheral_event event = {
        .type = ZMK_SPLIT_TRANSPORT_PERIPHERAL_EVENT_TYPE_KEY_POSITION_EVENT,
        .data.key_position_event = {.position = 28, .pressed = pressed},
    };
    return defy_hybrid_peripheral.api->report_event(&event);
}

static K_SEM_DEFINE(key_delivered, 0, 1);
static void deliver_key(struct k_work *work) {
    ARG_UNUSED(work);
    zassert_ok(key_event(true));
    k_sem_give(&key_delivered);
}
static K_WORK_DEFINE(key_work, deliver_key);

static K_SEM_DEFINE(service_blocked, 0, 1);
static K_SEM_DEFINE(service_release, 0, 1);
static void block_service(struct k_work *work) {
    ARG_UNUSED(work);
    k_sem_give(&service_blocked);
    k_sem_take(&service_release, K_FOREVER);
}
static K_WORK_DEFINE(service_blocker, block_service);

static bool cable_connected(void) {
    return defy_wired_peripheral.api->get_status().connections ==
           ZMK_SPLIT_TRANSPORT_CONNECTIONS_STATUS_ALL_CONNECTED;
}
static bool bluetooth_enabled(void) { return fake_links_snapshot().bluetooth_enabled; }
static bool bluetooth_disabled(void) { return !bluetooth_enabled(); }
static bool gate_open(void) { return fake_bluetooth_advertising_allowed(); }
static bool cable_key_held(void) { return fake_links_snapshot().cable_keys[3] == BIT(4); }

static void await_condition(bool (*condition)(void)) {
    int64_t end = k_uptime_get() + 350;
    while (!condition() && k_uptime_get() < end) {
        k_sleep(K_MSEC(1));
    }
    zassert_true(condition());
}

static void connect_bluetooth(void) {
    fake_bluetooth_available(true);
    await_condition(bluetooth_enabled);
    fake_bluetooth_connected(true);
    k_sleep(K_MSEC(5));
}

static void before(void *fixture) {
    ARG_UNUSED(fixture);
    fake_bluetooth_resume_stop();
    fake_bluetooth_delay_disconnect(false);
    defy_hybrid_peripheral_cancel_sleep();
    k_sleep(K_MSEC(25));
    zassert_ok(defy_hybrid_peripheral.api->set_enabled(true));
    zassert_ok(key_event(false));
    zassert_ok(defy_hybrid_peripheral.api->set_enabled(false));
    await_condition(bluetooth_disabled);
    k_sleep(K_MSEC(10));
    fake_links_reset();
    zassert_ok(defy_hybrid_peripheral.api->set_enabled(true));
    k_sleep(K_MSEC(CONFIG_DEFY_WIRED_PERIPHERAL_TIMEOUT_MS + 5));
}

static int await_prepare(bool cable_may_sleep) {
    int err;
    int64_t end = k_uptime_get() + 350;
    do {
        err = defy_hybrid_peripheral_prepare_sleep(0, cable_may_sleep);
        if (err != -EINPROGRESS) {
            return err;
        }
        k_sleep(K_MSEC(5));
    } while (k_uptime_get() < end);
    return err;
}

ZTEST(graceful, test_disconnect_finishes_before_transport_quiesce) {
    connect_bluetooth();
    fake_bluetooth_delay_disconnect(true);
    zassert_equal(defy_hybrid_peripheral_prepare_sleep(0, false), -EINPROGRESS);
    await_condition(bluetooth_disabled);
    size_t exchanges = fake_links_snapshot().cable_exchanges;
    k_sleep(K_MSEC(30));
    zassert_true(fake_links_snapshot().cable_exchanges > exchanges);
    zassert_equal(defy_hybrid_peripheral_prepare_sleep(0, false), -EINPROGRESS);
    fake_bluetooth_connected(false);
    zassert_ok(await_prepare(false));
    exchanges = fake_links_snapshot().cable_exchanges;
    k_sleep(K_MSEC(30));
    zassert_equal(fake_links_snapshot().cable_exchanges, exchanges);
    zassert_false(gate_open());
    zassert_equal(fake_bluetooth_ref_count(), 0);
}

ZTEST(graceful, test_pending_connection_without_connected_callback_vetoes_pm) {
    connect_bluetooth();
    fake_bluetooth_connected(false);
    fake_bluetooth_delay_disconnect(true);
    fake_bluetooth_state(BT_CONN_STATE_CONNECTING);
    zassert_equal(defy_hybrid_peripheral_prepare_sleep(0, false), -EINPROGRESS);
    await_condition(bluetooth_disabled);
    zassert_equal(defy_hybrid_peripheral_prepare_sleep(0, false), -EINPROGRESS);
    fake_bluetooth_state(BT_CONN_STATE_CONNECTED);
    zassert_equal(defy_hybrid_peripheral_prepare_sleep(0, false), -EINPROGRESS);
    fake_bluetooth_state(BT_CONN_STATE_DISCONNECTING);
    zassert_equal(defy_hybrid_peripheral_prepare_sleep(0, false), -EINPROGRESS);
    fake_bluetooth_state(BT_CONN_STATE_DISCONNECTED);
    zassert_ok(await_prepare(false));
}

ZTEST(graceful, test_key_cancels_inflight_stop_without_late_disable) {
    connect_bluetooth();
    fake_bluetooth_pause_stop();
    zassert_equal(defy_hybrid_peripheral_prepare_sleep(0, false), -EINPROGRESS);
    zassert_ok(fake_bluetooth_await_stop());
    zassert_equal(fake_bluetooth_ref_count(), 1);
    unsigned int calls = fake_links_snapshot().bluetooth_enable_calls;
    k_sem_reset(&key_delivered);
    zassert_true(k_work_submit(&key_work) >= 0);
    zassert_ok(k_sem_take(&key_delivered, K_MSEC(100)));
    zassert_equal(defy_hybrid_peripheral_prepare_sleep(0, false), -EBUSY);
    k_sleep(K_MSEC(30));
    zassert_equal(fake_links_snapshot().bluetooth_enable_calls, calls);
    zassert_false(gate_open());
    zassert_equal(fake_links_snapshot().bluetooth_keys[3], BIT(4));
    fake_bluetooth_resume_stop();
    await_condition(gate_open);
    await_condition(bluetooth_enabled);
    zassert_equal(fake_links_snapshot().bluetooth_enable_calls, calls + 2);
    zassert_equal(fake_bluetooth_ref_count(), 0);
    zassert_ok(key_event(false));
}

ZTEST(graceful, test_stuck_hci_request_times_out_without_blocking_system_work) {
    connect_bluetooth();
    fake_bluetooth_pause_stop();
    zassert_equal(defy_hybrid_peripheral_prepare_sleep(0, false), -EINPROGRESS);
    zassert_ok(fake_bluetooth_await_stop());
    size_t exchanges = fake_links_snapshot().cable_exchanges;
    k_sleep(K_MSEC(1010));
    zassert_equal(defy_hybrid_peripheral_prepare_sleep(0, false), -ETIMEDOUT);
    zassert_true(fake_links_snapshot().cable_exchanges > exchanges);
    zassert_false(gate_open());
    zassert_equal(defy_hybrid_peripheral_prepare_sleep(0, false), -EBUSY);
    fake_bluetooth_resume_stop();
    await_condition(gate_open);
    await_condition(bluetooth_enabled);
    k_sleep(K_MSEC(30));
    zassert_true(bluetooth_enabled());
}

ZTEST(graceful, test_disconnect_timeout_restores_backend_once) {
    connect_bluetooth();
    fake_bluetooth_delay_disconnect(true);
    zassert_equal(defy_hybrid_peripheral_prepare_sleep(0, false), -EINPROGRESS);
    await_condition(bluetooth_disabled);
    unsigned int calls = fake_links_snapshot().bluetooth_enable_calls;
    k_sleep(K_MSEC(1010));
    zassert_equal(defy_hybrid_peripheral_prepare_sleep(0, false), -ETIMEDOUT);
    await_condition(bluetooth_enabled);
    zassert_true(gate_open());
    zassert_equal(fake_links_snapshot().bluetooth_enable_calls, calls + 1);
    k_sleep(K_MSEC(100));
    zassert_equal(fake_links_snapshot().bluetooth_enable_calls, calls + 1);
}

ZTEST(graceful, test_failed_advertising_stop_restarts_enabled_backend) {
    connect_bluetooth();
    fake_bluetooth_stop_error(-EIO);
    unsigned int calls = fake_links_snapshot().bluetooth_enable_calls;
    zassert_equal(defy_hybrid_peripheral_prepare_sleep(0, false), -EINPROGRESS);
    zassert_equal(await_prepare(false), -EIO);
    await_condition(gate_open);
    zassert_true(bluetooth_enabled());
    zassert_equal(fake_links_snapshot().bluetooth_enable_calls, calls + 1);
    zassert_equal(fake_bluetooth_stop_calls(), 1);
    k_sleep(K_MSEC(100));
    zassert_equal(fake_links_snapshot().bluetooth_enable_calls, calls + 1);
    zassert_equal(fake_bluetooth_stop_calls(), 1);
}

ZTEST(graceful, test_live_cable_and_held_key_never_start_bluetooth_stop) {
    connect_bluetooth();
    zassert_ok(key_event(true));
    zassert_equal(defy_hybrid_peripheral_prepare_sleep(0, false), -EBUSY);
    zassert_equal(defy_hybrid_peripheral_prepare_sleep(0, true), -EBUSY);
    zassert_ok(key_event(false));
    fake_cable_online(true);
    await_condition(cable_connected);
    zassert_equal(defy_hybrid_peripheral_prepare_sleep(0, false), -EBUSY);
    zassert_equal(fake_bluetooth_stop_calls(), 0);
    zassert_true(gate_open());
}

ZTEST(graceful, test_permitted_live_cable_stops_bluetooth_then_quiesces) {
    connect_bluetooth();
    fake_cable_online(true);
    await_condition(cable_connected);
    fake_bluetooth_delay_disconnect(true);
    zassert_equal(defy_hybrid_peripheral_prepare_sleep(0, true), -EINPROGRESS);
    await_condition(bluetooth_disabled);
    size_t exchanges = fake_links_snapshot().cable_exchanges;
    k_sleep(K_MSEC(30));
    zassert_true(fake_links_snapshot().cable_exchanges > exchanges);
    zassert_equal(defy_hybrid_peripheral_prepare_sleep(0, true), -EINPROGRESS);
    zassert_true(cable_connected());
    fake_bluetooth_connected(false);
    zassert_ok(await_prepare(true));
    zassert_equal(fake_bluetooth_stop_calls(), 1);
    exchanges = fake_links_snapshot().cable_exchanges;
    k_sleep(K_MSEC(30));
    zassert_equal(fake_links_snapshot().cable_exchanges, exchanges);
    zassert_false(gate_open());

    defy_hybrid_peripheral_cancel_sleep();
    await_condition(gate_open);
    await_condition(bluetooth_enabled);
    zassert_ok(key_event(true));
    await_condition(cable_key_held);
    zassert_ok(key_event(false));
}

ZTEST(graceful, test_key_during_permitted_cable_stop_reaches_cable_and_restores_once) {
    connect_bluetooth();
    fake_cable_online(true);
    await_condition(cable_connected);
    fake_bluetooth_pause_stop();
    zassert_equal(defy_hybrid_peripheral_prepare_sleep(0, true), -EINPROGRESS);
    zassert_ok(fake_bluetooth_await_stop());
    unsigned int calls = fake_links_snapshot().bluetooth_enable_calls;
    zassert_ok(key_event(true));
    await_condition(cable_key_held);
    zassert_equal(defy_hybrid_peripheral_prepare_sleep(0, true), -EBUSY);
    k_sleep(K_MSEC(30));
    zassert_equal(fake_links_snapshot().bluetooth_enable_calls, calls);
    zassert_false(gate_open());
    fake_bluetooth_resume_stop();
    await_condition(gate_open);
    await_condition(bluetooth_enabled);
    zassert_equal(fake_links_snapshot().bluetooth_enable_calls, calls + 2);
    k_sleep(K_MSEC(100));
    zassert_equal(fake_links_snapshot().bluetooth_enable_calls, calls + 2);
    zassert_equal(fake_bluetooth_stop_calls(), 1);
    zassert_equal(fake_bluetooth_ref_count(), 0);
    zassert_true(cable_connected());
    zassert_true(cable_key_held());
    zassert_ok(key_event(false));
}

ZTEST(graceful, test_withdrawn_cable_permission_cancels_stop_and_restores_bluetooth) {
    connect_bluetooth();
    fake_cable_online(true);
    await_condition(cable_connected);
    fake_bluetooth_delay_disconnect(true);
    zassert_equal(defy_hybrid_peripheral_prepare_sleep(0, true), -EINPROGRESS);
    await_condition(bluetooth_disabled);
    unsigned int calls = fake_links_snapshot().bluetooth_enable_calls;
    zassert_equal(defy_hybrid_peripheral_prepare_sleep(0, true), -EINPROGRESS);
    zassert_equal(defy_hybrid_peripheral_prepare_sleep(0, false), -EBUSY);
    await_condition(gate_open);
    await_condition(bluetooth_enabled);
    zassert_equal(fake_links_snapshot().bluetooth_enable_calls, calls + 1);
    k_sleep(K_MSEC(100));
    zassert_equal(fake_links_snapshot().bluetooth_enable_calls, calls + 1);
    zassert_equal(fake_bluetooth_stop_calls(), 1);
    zassert_equal(fake_bluetooth_ref_count(), 0);
    zassert_true(cable_connected());
}

ZTEST(graceful, test_pending_advertiser_reference_is_retained_during_stop) {
    connect_bluetooth();
    fake_bluetooth_connected(false);
    fake_bluetooth_state(BT_CONN_STATE_CONNECTING);
    fake_bluetooth_pause_stop();
    zassert_equal(defy_hybrid_peripheral_prepare_sleep(0, false), -EINPROGRESS);
    zassert_ok(fake_bluetooth_await_stop());
    zassert_equal(fake_bluetooth_ref_count(), 1);
    fake_bluetooth_connected(true);
    fake_bluetooth_resume_stop();
    zassert_ok(await_prepare(false));
    zassert_equal(fake_bluetooth_ref_count(), 0);
    zassert_false(bluetooth_enabled());
}

ZTEST(graceful, test_key_cancels_queued_stop_before_any_controller_command) {
    connect_bluetooth();
    k_sem_reset(&service_blocked);
    k_sem_reset(&service_release);
    zassert_true(k_work_submit_to_queue(&service_work_q, &service_blocker) >= 0);
    zassert_ok(k_sem_take(&service_blocked, K_MSEC(100)));
    zassert_equal(defy_hybrid_peripheral_prepare_sleep(0, false), -EINPROGRESS);
    unsigned int calls = fake_links_snapshot().bluetooth_enable_calls;
    zassert_ok(key_event(true));
    zassert_equal(defy_hybrid_peripheral_prepare_sleep(0, false), -EBUSY);
    k_sleep(K_MSEC(20));
    zassert_equal(fake_links_snapshot().bluetooth_enable_calls, calls);
    k_sem_give(&service_release);
    k_sleep(K_MSEC(30));
    zassert_true(bluetooth_enabled());
    zassert_true(gate_open());
    zassert_equal(fake_bluetooth_stop_calls(), 0);
    zassert_equal(fake_links_snapshot().bluetooth_enable_calls, calls + 1);
    zassert_ok(key_event(false));
}

ZTEST_SUITE(graceful, NULL, NULL, before, NULL, NULL);
```
