## CMakeLists.txt
```
# SPDX-License-Identifier: MIT

cmake_minimum_required(VERSION 3.20.0)
include(${CMAKE_CURRENT_SOURCE_DIR}/../common/defy_test.cmake)
find_package(Zephyr REQUIRED HINTS $ENV{ZEPHYR_BASE})
project(defy_wired_central_test)

# The cable central with battery, control, lighting and the version report.
target_sources(app PRIVATE src/main.c src/fake_spi.c
                           ${DEFY_ROOT}/drivers/split/defy_wired_protocol.c
                           ${DEFY_ROOT}/battery/defy_battery_protocol.c
                           ${DEFY_ROOT}/battery/defy_half_version_protocol.c
                           ${DEFY_ROOT}/lighting/defy_feedback_protocol.c
                           ${DEFY_ROOT}/lighting/defy_lighting_protocol.c)
target_include_directories(app PRIVATE ${DEFY_ZMK_APP}/include)
target_compile_definitions(app PRIVATE
  CONFIG_DEFY_BATTERY=1
  CONFIG_DEFY_CONTROL=1
  CONFIG_DEFY_LIGHTING=1
  CONFIG_DEFY_HALF_VERSION=1
  CONFIG_DEFY_KEY_TRACE=1
  CONFIG_ZMK_LOG_LEVEL=3
  CONFIG_DEFY_WIRED_CENTRAL_STACK_SIZE=4096
  CONFIG_DEFY_WIRED_CENTRAL_THREAD_PRIORITY=5
  CONFIG_DEFY_WIRED_CENTRAL_TIMEOUT_MS=250)
```

## prj.conf
```kconfig
# SPDX-License-Identifier: MIT

CONFIG_ZTEST=y
CONFIG_SPI=y
CONFIG_SPI_ASYNC=y
CONFIG_SPI_SLAVE=y
CONFIG_LOG=y
CONFIG_ASSERT=y
```

## app.overlay
```dts
/* SPDX-License-Identifier: MIT */

/ {
    defy_cables: cables {
        compatible = "dygma,defy-neuron-cables";
        spi-ports = <&test_spi0 &test_spi1>;
        run-gpios = <&gpio0 29 0>, <&gpio0 28 0>;
        i2c-bus = <&i2c0>;
    };
    test_spi0: test-spi0 {
        compatible = "dygma,wired-test-spi";
        #address-cells = <1>;
        #size-cells = <0>;
        status = "okay";
    };
    test_spi1: test-spi1 {
        compatible = "dygma,wired-test-spi";
        #address-cells = <1>;
        #size-cells = <0>;
        status = "okay";
    };
};
```

## src/fake_spi.c
```c
/* SPDX-License-Identifier: MIT */

#include <string.h>

#include <zephyr/device.h>
#include <zephyr/ztest.h>

#include "fake_spi.h"

static int fake_transceive(const struct device *device, const struct spi_config *config,
                          const struct spi_buf_set *tx, const struct spi_buf_set *rx,
                          spi_callback_t callback, void *userdata) {
    struct fake_spi *state = device->data;
    zassert_false(state->active);
    zassert_equal(config->operation,
                  SPI_OP_MODE_SLAVE | SPI_MODE_CPHA | SPI_WORD_SET(8) | SPI_TRANSFER_MSB);
    zassert_equal(tx->count, 1);
    zassert_equal(rx->count, 1);
    zassert_equal(tx->buffers[0].len, DEFY_WIRED_FRAME_SIZE);
    zassert_equal(rx->buffers[0].len, DEFY_WIRED_FRAME_SIZE);
    if (state->arm_error) {
        int err = state->arm_error;
        state->arm_error = 0;
        return err;
    }
    state->tx = tx;
    state->rx = rx;
    state->callback = callback;
    state->userdata = userdata;
    state->active = true;
    memcpy(state->armed_tx, tx->buffers[0].buf, DEFY_WIRED_FRAME_SIZE);
    return 0;
}

static DEVICE_API(spi, fake_spi_api) = {.transceive_async = fake_transceive};
struct fake_spi fake_spi0;
struct fake_spi fake_spi1;
DEVICE_DT_DEFINE(DT_NODELABEL(test_spi0), NULL, NULL, &fake_spi0, NULL, POST_KERNEL, 50,
                 &fake_spi_api);
DEVICE_DT_DEFINE(DT_NODELABEL(test_spi1), NULL, NULL, &fake_spi1, NULL, POST_KERNEL, 50,
                 &fake_spi_api);
```

## src/fake_spi.h
```c
/*
 * The Neuron's two cable ports, as SPI slaves on the test nodes of app.overlay.
 * A transfer the central arms stays active until the test completes it.
 *
 * SPDX-License-Identifier: MIT
 */

#ifndef DEFY_TEST_FAKE_SPI_H
#define DEFY_TEST_FAKE_SPI_H

#include <stdbool.h>
#include <stdint.h>

#include <zephyr/drivers/spi.h>

#include <dygma/defy_wired_protocol.h>

struct fake_spi {
    const struct spi_buf_set *tx;
    const struct spi_buf_set *rx;
    spi_callback_t callback;
    void *userdata;
    bool active;
    /* Returned once by the next transfer the central arms. */
    int arm_error;
    uint8_t armed_tx[DEFY_WIRED_FRAME_SIZE];
};

extern struct fake_spi fake_spi0;
extern struct fake_spi fake_spi1;

#endif
```
