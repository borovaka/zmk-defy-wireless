## dts/bindings/bluetooth/dygma,defy-bt-hci-spi.yaml
```yaml
# SPDX-License-Identifier: MIT

description: |
  The nRF52820 Bluetooth controller on a Defy half's RF board, over SPI. Like
  zephyr,bt-hci-spi, without a reset line: the driver brings the controller to
  a fresh boot over SPI. See drivers/bluetooth/defy_hci_spi.c.

compatible: "dygma,defy-bt-hci-spi"

include: [spi-device.yaml, bt-hci.yaml]

properties:
  irq-gpios:
    type: phandle-array
    required: true
    description: Data ready from the controller, high while it has a message.

  controller-data-delay-us:
    type: int
    default: 20
    description: |
      Delay between a header and the message or packet after it, for the
      controller to arm the transfer. As in zephyr,bt-hci-spi.

  bt-hci-name:
    default: "SPI"

  bt-hci-bus:
    default: "spi"
```

## dts/bindings/led_strip/dygma,defy-leds.yaml
```yaml
# SPDX-License-Identifier: MIT

description: |
  The Defy's lights as one LED strip: the per-key LEDs first, then the
  underglow chain.

compatible: "dygma,defy-leds"

properties:
  chain-length:
    type: int
    required: true
    description: Number of pixels, the sum of the parts' chain-length.

  key-leds:
    type: phandle
    required: true
    description: LED strip of the per-key LEDs.

  underglow:
    type: phandle
    required: true
    description: LED strip of the underglow chain.

  underglow-power-gpios:
    type: phandle-array
    required: true
    description: |
      Switches the underglow chain's supply (UG_EN). The LEDs draw current even
      when dark, so the supply is on only while an underglow LED is lit.

  underglow-power-on-delay-us:
    type: int
    default: 1000
    description: |
      Wait after switching the underglow supply on, before sending a frame.
      The default is a guess; nothing about the chain's power-up is measured.

  underglow-inverted:
    type: boolean
    description: |
      The underglow data line passes through an inverter. RP2040 only: inverts
      the output of the underglow strip's data pin, its gpios property, once
      the strip driver has set the pin up.
```

## dts/bindings/led_strip/dygma,ws2812-rpi-pico-pio.yaml
```yaml
# SPDX-License-Identifier: MIT

description: |
  WS2812 strips on the RP2040's PIO. The same as Zephyr's
  worldsemi,ws2812-rpi_pico-pio, for a copy of Zephyr 4.1's driver with four
  fixes: four-channel pixels shifted by one byte, a program that runs only at
  PIO offset 0, a clock divider without its fraction and an unchecked
  pio_add_program(). See drivers/led_strip/ws2812_rpi_pico_pio.c.

compatible: "dygma,ws2812-rpi-pico-pio"

include: pinctrl-device.yaml

properties:
  bit-waveform:
    type: array
    description: |
      T0, T1 and T2 as parts of one bit period, as in Zephyr's
      worldsemi,ws2812-rpi_pico-pio. A 0 is high for T0 and a 1 for T0+T1.

child-binding:
  description: |
    A strip on this PIO. Up to 4 per PIO node.

  include: ws2812-gpio.yaml

  properties:
    gpios:
      description: |
        Only the pin number is used. The pin is set up by the parent node's
        pinctrl.

    frequency:
      type: int
      description: |
        Bits per second. 800000 for WS2812 and SK6812.
```

## dts/bindings/led_strip/issi,is31fl3743b.yaml
```yaml
# SPDX-License-Identifier: MIT

description: |
  ISSI IS31FL3743B LED matrix driver on SPI, exposed as an LED strip.

  Each pixel is a group of consecutive PWM registers on page 0, one per entry
  in color-mapping. pwm-registers gives the first register of each pixel. The
  defaults for the configuration registers are the stock Defy values.

compatible: "issi,is31fl3743b"

include: [spi-device.yaml, led-strip.yaml]

properties:
  sdb-gpios:
    type: phandle-array
    description: |
      Hardware shutdown input SDB, active when the chip is on. The driver keeps
      the chip shut down while every pixel is off.

  pwm-registers:
    type: uint8-array
    required: true
    description: |
      First PWM register (0x01-0xC6) of each pixel, in pixel order. The PWM
      register for SWx, CSy is (x - 1) * 18 + y.

  config-register:
    type: int
    default: 0x29
    description: |
      Configuration register, page 2, 00h. The default selects SW1-SW9 and
      normal operation.

  global-current:
    type: int
    default: 0xff
    description: Global current control register, page 2, 01h.

  pull-register:
    type: int
    default: 0xb3
    description: |
      Pull-down/up resistor selection register, page 2, 02h. The default turns
      on the 180 degree phase delay with a 2 kOhm SW pull-down and CS pull-up.

  scaling:
    type: int
    default: 0xff
    description: Value written to every scaling register on page 1.
```

## dts/bindings/lighting/dygma,defy-key-lighting.yaml
```yaml
# SPDX-License-Identifier: MIT

description: |
  Colours for single keys on a keymap layer. Each child gives some keys of one
  layer a colour of its own, at full strength and scaled by the brightness,
  while that layer decides the colours: the highest active layer with colours
  here or in &defy_layer_lighting. A key in two children takes the later
  one's colour. At most 16 children. dt-bindings/dygma/defy_lighting.h has the
  colours, and docs/lighting.md describes them.

compatible: "dygma,defy-key-lighting"

child-binding:
  description: Keys of one layer in one colour.
  properties:
    layer:
      type: int
      required: true
      description: The layer, numbered as &mo and &tog number it.
    key-positions:
      type: array
      required: true
      description: The keys, numbered as ZMK's combos number them, 0 to 69.
    colour:
      type: int
      required: true
      description: The keys' colour as 0xRRGGBB; 0 leaves them dark.
```

## dts/bindings/lighting/dygma,defy-layer-lighting.yaml
```yaml
# SPDX-License-Identifier: MIT

description: |
  Colours for keymap layers. Each child gives a layer the colours it shows
  instead of the look's, at full strength and scaled by the brightness. The
  highest active layer with a child decides; a colour it leaves out comes
  from the look. dt-bindings/dygma/defy_lighting.h has the colours, and
  docs/lighting.md describes them.

compatible: "dygma,defy-layer-lighting"

child-binding:
  description: A layer's colours.
  properties:
    layer:
      type: int
      required: true
      description: The layer, numbered as &mo and &tog number it.
    keys:
      type: int
      description: The per-key LEDs' colour as 0xRRGGBB; 0 leaves them dark.
    underglow:
      type: int
      description: The underglow's colour as 0xRRGGBB; 0 leaves it dark.
```

## dts/bindings/split/dygma,defy-neuron-cables.yaml
```yaml
# SPDX-License-Identifier: MIT

description: |
  The Neuron's two cable sockets to the Defy halves. Each cable carries an SPI
  link, on which the Neuron is the slave, and the half's RP2040 RUN line. The
  I2C bus to the halves' bootloaders runs through both.

compatible: "dygma,defy-neuron-cables"

properties:
  spi-ports:
    type: phandles
    required: true
    description: The SPI slave on socket 1, then the one on socket 2.

  run-gpios:
    type: phandle-array
    required: true
    description: |
      The left half's RUN line, then the right half's, active high and without
      pull. A cabled half's own pull-up reads high, which shows that its cable
      is in. Driven low, a line holds that half in reset.

  i2c-bus:
    type: phandle
    required: true
    description: The I2C bus to the halves' bootloaders.
```

## dts/bindings/split/dygma,defy-wired-peripheral.yaml
```yaml
# SPDX-License-Identifier: MIT

description: |
  A Defy half's cable link to the Neuron: the SPI device the half polls as
  master. Each half's devicetree has exactly one.

compatible: "dygma,defy-wired-peripheral"

include: spi-device.yaml

properties:
  half-id:
    type: int
    required: true
    enum: [0, 1]
    description: |
      Which half this is, 0 for the left and 1 for the right. A half reports
      only its own key positions.
```

## lighting/Kconfig
```kconfig
# SPDX-License-Identifier: MIT

config DEFY_LIGHTING
    bool "Defy half lighting and host feedback"
    default y
    depends on DEFY_HYBRID && SETTINGS
    select DEFY_CONTROL
    select CRC if ZMK_SPLIT_ROLE_CENTRAL
    help
      The halves' lighting and its controls, with the looks and layer
      colours the keymap sets, the overlay that shows the selected Bluetooth
      profile and output on the halves' keys, and the Bluetooth profile
      chooser. See docs/lighting.md.

config DEFY_HALF_LEDS
    bool "A half's LED interface"
    default y
    depends on DT_HAS_DYGMA_DEFY_LEDS_ENABLED
    select LED_STRIP
    help
      Everything a half shows on its LEDs: how far its start-up got, from
      ZMK running through the radio firmware install to Bluetooth and the
      link to the Neuron, a report when the radio fails, and the displays
      the Neuron asks for: the lighting state, the battery display's cells, the
      host overlay and the profile chooser. The half's own low-battery
      warning shows there too. See docs/lighting.md. ZMK's RGB underglow
      must stay off, as it drives the same LEDs.
```

## power/Kconfig
```kconfig
# SPDX-License-Identifier: MIT

config DEFY_HALF_SLEEP
    bool "Defy half dormant sleep"
    depends on SOC_RP2040 && DEFY_HYBRID && !ZMK_SPLIT_ROLE_CENTRAL
    depends on DEFY_BT_PERSISTENT_ID
    depends on !ZMK_SLEEP && !ZMK_PM_SOFT_OFF
    select POWEROFF
    select PM_DEVICE
    select PM_DEVICE_SYSTEM_MANAGED
    select ZMK_PM_DEVICE_SUSPEND_RESUME
    default y
    help
      Puts an idle half into the RP2040's DORMANT state, in place of ZMK's
      own sleep: Bluetooth shut down and the radio powered off, the LED
      drivers suspended, every clock stopped. A key press restarts the half.
      A half stays awake while a key is held, its cable link is up, the
      battery display shows, or its last battery sample reports charging or
      charge complete. docs/power-and-wake.md has the details.

config DEFY_HALF_SLEEP_TIMEOUT_MS
    int "Defy half inactivity before dormant sleep (ms)"
    depends on DEFY_HALF_SLEEP
    range 1000 86400000
    default 300000
    help
      How long a half goes without a key change before it sleeps, if
      nothing else keeps it awake.
```

## soc/rp2040/Kconfig
```kconfig
# SPDX-License-Identifier: MIT

config DEFY_RP2040_FACTORY_HANDOFF
    bool "Defy RP2040 factory watchdog handoff"
    default y
    depends on SOC_RP2040 && FLASH_LOAD_OFFSET = 0x6100
    select SOC_RESET_HOOK
    select INIT_ARCH_HW_AT_BOOT
    help
      For an image that Dygma's RP2040 bootloader starts at 0x6100. The
      bootloader leaves its watchdog running, which the reset hook stops
      before Zephyr starts. With DEFY_FATAL_RECOVERY the hook also runs
      defy_fatal_recovery_boot(), which counts quick faults.

config DEFY_RP2040_USB_CLOCKS_OFF
    bool "Defy RP2040 USB PLL off"
    default y
    depends on BOARD_DEFY_LEFT || BOARD_DEFY_RIGHT
    depends on CLOCK_CONTROL_RPI_PICO
    depends on !USB_DEVICE_STACK && !USB_DEVICE_STACK_NEXT && !ADC && !COUNTER && !RTC
    help
      Turns off the USB PLL, which runs at 48 MHz, and the USB, ADC and
      RTC clocks it drives, after Zephyr's clock driver has started them.
      The halves use none of them, so this saves power while a half is
      awake.
```

## status/Kconfig
```kconfig
# SPDX-License-Identifier: MIT

config DEFY_NEURON_STATUS_LED
    bool "Defy Neuron status LED"
    default y
    depends on $(dt_nodelabel_enabled,led_green) && $(dt_nodelabel_enabled,led_red)
    depends on ZMK_USB
    select PWM
    help
      Lights the Neuron's LED green while a USB host has configured HID and
      is not suspended, and blinks it amber while the half updater holds
      the halves. See docs/lighting.md.

config DEFY_NEURON_STATUS_LED_BRIGHTNESS
    int "Defy Neuron status LED brightness in percent"
    depends on DEFY_NEURON_STATUS_LED
    range 1 100
    default 3

config DEFY_NEURON_DOCK
    bool "Defy Neuron cable and dock detection"
    default y
    depends on ZMK_USB && GPIO
    depends on DT_HAS_DYGMA_DEFY_NEURON_CABLES_ENABLED
    help
      Reads the halves' RUN lines to tell which cables are in and whether
      the Neuron is docked, on a computer, on a charger or alone. Lighting
      marks the docked state on the halves, and the half updater reports it.
      After 5 s with no computer, and one cable in or no USB power, the
      lighting state tells the halves that the Neuron runs on battery, so
      that a cable keeps neither awake. Without this option a half's live
      cable always keeps it awake. See docs/automatic-transports.md and
      docs/power-and-wake.md.
```

## studio/Kconfig
```kconfig
# SPDX-License-Identifier: MIT

config DEFY_STUDIO_USB_PRIORITY
    bool "Keep Studio on an available USB connection"
    default y
    depends on ZMK_STUDIO_TRANSPORT_UART && (ZMK_USB || ARCH_POSIX)
    help
      Lets Studio work over USB whichever output carries the keys. While a
      USB host is ready, Studio's RPC sees USB as the selected endpoint, and
      a Bluetooth Studio disconnect does not lock Studio. Key reports keep
      the selected output.
```

## tests/drivers/common/dts/bindings/dygma,loader-test-pwm.yaml
```yaml
# SPDX-License-Identifier: MIT

description: |
  Defy test PWM controller with pin control, for the UF2 loader's LED suite,
  which takes the LED pins from the PWM's pin configuration
compatible: "dygma,loader-test-pwm"
include: [pwm-controller.yaml, base.yaml, pinctrl-device.yaml]

properties:
  reg:
    required: true

  "#pwm-cells":
    const: 3

pwm-cells:
  - channel
  - period
  - flags
```

## tests/drivers/common/dts/bindings/dygma,radio-test-spi.yaml
```yaml
# SPDX-License-Identifier: MIT

description: Defy radio test SPI controller, faked by the suites that use it
compatible: "dygma,radio-test-spi"
include: spi-controller.yaml
```

## tests/drivers/common/dts/bindings/dygma,wired-test-spi.yaml
```yaml
# SPDX-License-Identifier: MIT

description: Defy cable test SPI controller, faked by the suites that use it
compatible: "dygma,wired-test-spi"
include: spi-controller.yaml
```

## tests/drivers/defy_half_sleep/dts/bindings/dygma,half-sleep-test-device.yaml
```yaml
# SPDX-License-Identifier: MIT

description: Half sleep test device
compatible: "dygma,half-sleep-test-device"
include: base.yaml
```

## updater/Kconfig
```kconfig
# SPDX-License-Identifier: MIT

DT_CHOSEN_DEFY_HALF_UPDATER_UART := dygma,half-updater-uart

config DEFY_HALF_UPDATER
    bool "Defy half firmware updater"
    default y
    depends on DEFY_HYBRID && ZMK_SPLIT_ROLE_CENTRAL && SOC_NRF52833
    depends on ZMK_USB && USB_CDC_ACM && UART_LINE_CTRL
    depends on $(dt_chosen_enabled,$(DT_CHOSEN_DEFY_HALF_UPDATER_UART))
    depends on DT_HAS_DYGMA_DEFY_NEURON_CABLES_ENABLED
    select I2C
    select CRC
    select RING_BUFFER
    select DEFY_UPDATE_GUARD
    help
      Writes the halves' firmware over the cables, through their factory I2C
      bootloaders, and answers the installer's status requests, on a USB
      serial port of its own. The defy-half-updater snippet adds that port
      and the options it needs. See docs/half-updater.md.
```
