## drivers/split/Kconfig
```kconfig
# SPDX-License-Identifier: MIT

menuconfig DEFY_HYBRID
    bool "Defy automatic cable and Bluetooth split transport"
    default y
    depends on ZMK_SPLIT && ZMK_SPLIT_BLE && SPI && !ZMK_SPLIT_WIRED
    depends on DT_HAS_DYGMA_DEFY_WIRED_PERIPHERAL_ENABLED || DT_HAS_DYGMA_DEFY_NEURON_CABLES_ENABLED
    select DEFY_WIRED
    help
      Keeps both of a half's links to the Neuron up, the cable and ZMK's
      Bluetooth split, and has the Neuron pick one for each half. Its split
      transport, which ZMK enables at priority 0, drives the cable and ZMK's
      Bluetooth transport beneath it. See docs/automatic-transports.md.

if DEFY_HYBRID

if !ZMK_SPLIT_ROLE_CENTRAL

config DEFY_HYBRID_PERIPHERAL_POLL_MS
    int "Half transport status interval in milliseconds"
    default 20
    range 5 100
    help
      How often a half checks both links' status while keys are in use.

config DEFY_HYBRID_IDLE_TIMEOUT_MS
    int "Milliseconds without key activity before connected idle"
    default 30000
    range 100 3600000
    help
      Time without a key change, with no key held, after which a half polls
      less often. See connected idle in docs/power-and-wake.md.

config DEFY_HYBRID_IDLE_STATUS_POLL_MS
    int "Idle half transport status interval in milliseconds"
    default 100
    range 20 500
    help
      How often an idle half checks both links' status.

config DEFY_HYBRID_IDLE_CABLE_POLL_MS
    int "Idle connected cable poll interval in milliseconds"
    default 20
    range 2 100
    help
      How often an idle half polls a connected cable.

config DEFY_HYBRID_IDLE_CABLE_PROBE_MS
    int "Idle disconnected cable probe interval in milliseconds"
    default 100
    range 20 1000
    help
      How often an idle half probes a cable that is not connected.

config DEFY_HYBRID_CABLE_PROBE_MS
    int "Disconnected half cable probe interval in milliseconds"
    default 20
    range 5 100
    help
      How often a half probes a cable that is not connected while keys are
      in use.

config DEFY_HYBRID_SNAPSHOT_INTERVAL_MS
    int "Half Bluetooth snapshot interval in milliseconds"
    default 100
    range 20 500
    help
      How often a half connected over Bluetooth notifies the Neuron of all
      its key positions while keys are in use, which puts them right after
      a lost notification.

config DEFY_HYBRID_IDLE_SNAPSHOT_INTERVAL_MS
    int "Idle half Bluetooth snapshot interval in milliseconds"
    default 400
    range 20 450
    help
      How often an idle half connected over Bluetooth notifies the Neuron of
      all its key positions. The Neuron stops using a half's Bluetooth link
      after CONFIG_DEFY_HYBRID_BLE_TIMEOUT_MS without a snapshot, 1000 ms by
      default. That option is set in the Neuron's build, where a half
      cannot check it. Up to 450 ms, one lost snapshot still leaves the
      next inside that timeout.

endif

if ZMK_SPLIT_ROLE_CENTRAL

config DEFY_HYBRID_QUEUE_SIZE
    int "Neuron pending snapshot capacity"
    default 128
    range 16 512
    help
      Key snapshots from both links that the Neuron can hold before it
      turns them into ZMK key events. A full queue holds back the cable's
      acknowledgement, and the half sends the snapshot again.

config DEFY_HYBRID_BLE_TIMEOUT_MS
    int "Neuron Bluetooth snapshot timeout in milliseconds"
    default 1000
    range 900 5000
    help
      How long the Neuron keeps using a half's last Bluetooth snapshot
      without a new one before it releases the half's keys. Keep it above
      twice the halves' CONFIG_DEFY_HYBRID_IDLE_SNAPSHOT_INTERVAL_MS, 400 ms
      by default, so that one lost idle snapshot does not count.

config DEFY_HYBRID_BLE_SCAN_FAST_MS
    int "Neuron fast scan period in milliseconds"
    default 60000
    range 1000 3600000
    help
      How long the Neuron scans fast for a missing half, a 30 ms window
      every 60 ms, after it starts, after a half's Bluetooth link drops,
      after a half's cable drops while it has no Bluetooth link, and after
      the half updater's maintenance or a split pairing reset. It then
      scans slowly until the next of these.

config DEFY_HYBRID_BLE_SCAN_SLOW_INTERVAL_MS
    int "Neuron slow scan interval in milliseconds"
    default 640
    range 3 10240
    help
      How often the Neuron's slow scan for a missing half opens a window.
      Keep it well under 1.28 s. A bonded half that wakes advertises at
      high duty cycle for at most 1.28 s, and a window usually falls within
      that. If none does, the half advertises every 100 to 150 ms instead,
      and the slow scan finds it after a few seconds. An interval of 60
      with a window of 30 always scans fast.

config DEFY_HYBRID_BLE_SCAN_SLOW_WINDOW_MS
    int "Neuron slow scan window in milliseconds"
    default 20
    range 3 10240
    help
      How long each window of the slow scan listens. It must not exceed
      the interval.

config DEFY_HYBRID_HANDOFF_GRACE_MS
    int "Cable to Bluetooth handoff grace period in milliseconds"
    default 200
    range 50 500
    help
      After a half's cable drops, how long the Neuron waits for a Bluetooth
      snapshot newer than the loss before it releases the half's keys.

endif

endif

menuconfig DEFY_WIRED
    bool "Defy cable split transport"
    default y
    depends on ZMK_SPLIT && SPI
    depends on DT_HAS_DYGMA_DEFY_WIRED_PERIPHERAL_ENABLED || DT_HAS_DYGMA_DEFY_NEURON_CABLES_ENABLED
    # The cable runs beside ZMK's Bluetooth split, under the hybrid transport.
    depends on DEFY_HYBRID && !ZMK_SPLIT_WIRED
    # The Neuron is the SPI slave on both cables.
    select SPI_SLAVE if ZMK_SPLIT_ROLE_CENTRAL
    select SPI_ASYNC if ZMK_SPLIT_ROLE_CENTRAL
    help
      The split link over the stock cable, with this port's SPI protocol: a
      half polls as SPI master, and the Neuron answers on both sockets as SPI
      slave. DEFY_HYBRID selects it.

if DEFY_WIRED

if !ZMK_SPLIT_ROLE_CENTRAL

config DEFY_WIRED_PRIORITY
    int "Half cable transport priority"
    default 10
    range 0 99
    help
      The cable's place among a half's split transports. ZMK enables the
      first available transport in the order of the string
      "<priority>_<name>", not of the number. 10 sorts after the hybrid
      transport's 0, which ZMK selects and which drives
      the cable itself, and before the 20 the boards give
      ZMK_SPLIT_BLE_PRIORITY.

config DEFY_WIRED_POLL_INTERVAL_MS
    int "Half cable poll interval in milliseconds"
    default 2
    range 1 20
    help
      How often a half polls a connected cable while keys are in use.

config DEFY_WIRED_PERIPHERAL_TIMEOUT_MS
    int "Half acknowledgement timeout in milliseconds"
    default 100
    range 50 2000
    help
      Time without a valid acknowledgement after which a half drops the
      cable connection and starts a new session.

config DEFY_WIRED_PERIPHERAL_STACK_SIZE
    int "Half cable worker stack size"
    default 4096
    help
      Stack of the half's thread that polls the cable.

config DEFY_WIRED_PERIPHERAL_THREAD_PRIORITY
    int "Half cable worker priority"
    default 5
    help
      The thread runs at K_PRIO_PREEMPT() of this value.

endif

if ZMK_SPLIT_ROLE_CENTRAL

config DEFY_WIRED_CENTRAL_TIMEOUT_MS
    int "Neuron disconnect timeout in milliseconds"
    default 250
    range 50 2000
    help
      Time without valid data after which the Neuron gives up on a cable
      and releases that half's keys.

config DEFY_WIRED_CENTRAL_STACK_SIZE
    int "Neuron cable worker stack size"
    default 4096
    help
      Stack of the Neuron's thread that services both cable sockets.

config DEFY_WIRED_CENTRAL_THREAD_PRIORITY
    int "Neuron cable worker priority"
    default 5
    help
      The thread runs at K_PRIO_PREEMPT() of this value.

endif

endif
```

## drivers/usb/Kconfig
```kconfig
# SPDX-License-Identifier: MIT

config DEFY_USB_REPORT_RECOVERY
    bool "Defy USB held-state recovery after host wake"
    default y
    depends on ZMK_USB && ZMK_SPLIT_ROLE_CENTRAL
    depends on DEFY_HYBRID
    depends on !ZMK_USB_BOOT
    help
      Sends the current keyboard, consumer and, with ZMK_POINTING, mouse
      reports again after a USB resume, retries failed sends, and asks the
      host to wake only for a newly pressed key. See docs/power-and-wake.md.

config DEFY_USB_REPORT_TRACE
    bool "Trace Defy USB status and report modifiers"
    depends on DEFY_USB_REPORT_RECOVERY && LOG
    help
      Logs USB status, endpoint changes and the modifiers of each report.
      The neuron-hybrid-log build turns it on.

config DEFY_USB_POSITION_TRACE
    bool "Log each key position event"
    depends on DEFY_USB_REPORT_TRACE
    help
      Also logs the position of each key event, to line presses up with the
      USB reports.
```

## dts/bindings/behaviors/dygma,defy-battery-display.yaml
```yaml
# SPDX-License-Identifier: MIT

description: Show each Defy half's battery level on its keys
compatible: "dygma,defy-battery-display"
include: zero_param.yaml
```

## dts/bindings/behaviors/dygma,defy-lighting.yaml
```yaml
# SPDX-License-Identifier: MIT

description: |
  The Defy's lighting controls. The parameter is a command from
  dt-bindings/dygma/defy_lighting.h. Each child is a look: a key colour and an
  underglow colour at full strength, scaled by the brightness. The first look
  is the initial one, and DEFY_LIGHTING_NEXT steps through them. Without
  children the Neuron uses its four built-in looks. See docs/lighting.md.

compatible: "dygma,defy-lighting"

include: one_param.yaml

properties:
  brightness:
    type: int
    default: 24
    description: |
      Initial brightness, 1 to 255. DEFY_LIGHTING_BRIGHTER and
      DEFY_LIGHTING_DIMMER step it through 4, 8, 12, 16, 24, 32, 48, 64, 96,
      128, 192 and 255.

child-binding:
  description: A look.
  properties:
    keys:
      type: int
      default: 0
      description: The per-key LEDs' colour as 0xRRGGBB; 0, the default, leaves them dark.
    underglow:
      type: int
      default: 0
      description: The underglow's colour as 0xRRGGBB; 0, the default, leaves it dark.
```

## dts/bindings/behaviors/dygma,defy-profile-chooser.yaml
```yaml
# SPDX-License-Identifier: MIT

description: |
  Bluetooth profile chooser. While it is open, the halves show the profiles
  and its keys select, clear or close; docs/lighting.md describes it. The
  positions are the Defy's, as the Neuron's keymap numbers them.

compatible: "dygma,defy-profile-chooser"

include: zero_param.yaml

properties:
  select-positions:
    type: array
    default: [1, 2, 3, 4, 5, 8, 9, 10, 11, 12]
    description: |
      The keys that select profiles 1 to 10, prefer Bluetooth and close the
      chooser: 1 to 5 on the left half, 6 to 0 on the right.
  clear-positions:
    type: array
    default: [15, 16, 17, 18, 19, 22, 23, 24, 25, 26]
    description: |
      The keys that clear a profile when held for three seconds, in the order
      of select-positions: Q to T and Y to P, below the keys that select.
  usb-positions:
    type: array
    default: [0, 13]
    description: The keys that prefer USB and close the chooser, = and -.
  close-positions:
    type: array
    default: [28, 45, 46]
    description: The keys that close the chooser, Esc, C and V.
```

## dts/bindings/behaviors/dygma,defy-uf2-drive.yaml
```yaml
# SPDX-License-Identifier: MIT

description: Restart the Neuron into the UF2 loader's drive
compatible: "dygma,defy-uf2-drive"
include: zero_param.yaml
```
