## Kconfig
```kconfig
# SPDX-License-Identifier: MIT

rsource "drivers/Kconfig"
rsource "diagnostics/Kconfig"
rsource "power/Kconfig"
rsource "battery/Kconfig"
rsource "lighting/Kconfig"
rsource "bootloader/Kconfig"
rsource "status/Kconfig"
rsource "updater/Kconfig"
rsource "studio/Kconfig"
rsource "soc/rp2040/Kconfig"
```

## battery/Kconfig
```kconfig
# SPDX-License-Identifier: MIT

config DEFY_CONTROL
    bool
    depends on DEFY_HYBRID
    help
      The Neuron's control channel to each half, as dygma/defy_control.h
      describes it: the GATT service on each half, its client on the
      Neuron, and the Neuron's commands over the cable. DEFY_BATTERY,
      DEFY_LIGHTING and DEFY_HALF_VERSION select it for what they send
      over it.

config DEFY_BATTERY
    bool "Defy battery telemetry"
    default y
    depends on DEFY_HYBRID && BT
    select DEFY_CONTROL
    select DEFY_BATTERY_HCI if DEFY_BT_HCI_SPI
    help
      Each half's battery level and charger state, which its radio
      measures: the battery display's cells and the low-battery warning on the half's
      keys, and on the Neuron the lower of the halves' levels through the
      Bluetooth Battery Service. See docs/battery.md.

if DEFY_BATTERY

module = DEFY_BATTERY
module-str = Defy battery
source "subsys/logging/Kconfig.template.log_config"

endif

config DEFY_BATTERY_HCI
    bool
    depends on DEFY_BT_HCI_SPI
    select BT_HCI_VS_EVT_USER
    help
      The half's decoder of the radio's battery events,
      drivers/bluetooth/defy_battery_hci.c.

config DEFY_HALF_VERSION
    bool "Defy halves' version report"
    default y
    depends on DEFY_HYBRID && BT
    select DEFY_CONTROL
    select CRC
    help
      Each half reports its side, its program's CRC32 and seal version and
      the module version it was built from, in a third characteristic of
      its control service and in 'DV' cable frames. The Neuron keeps the
      latest report from each half for the half updater's HALF VERSIONS.
      See docs/versions.md.
```

## boards/dygma/defy/Kconfig.defconfig
```kconfig
# SPDX-License-Identifier: MIT

if BOARD_DEFY_LEFT || BOARD_DEFY_RIGHT

config ZMK_KEYBOARD_NAME
    default "Defy"

config ZMK_SPLIT
    default y

# SysTick runs from clk_sys, 48 MHz in defy.dtsi.
config SYS_CLOCK_HW_CYCLES_PER_SEC
    default $(dt_node_int_prop_int,$(dt_nodelabel_path,clk_sys),clock-frequency)

endif # BOARD_DEFY_LEFT || BOARD_DEFY_RIGHT
```

## boards/dygma/defy/board.yml
```yaml
# SPDX-License-Identifier: MIT

boards:
  - name: defy_left
    full_name: Dygma Defy, left half
    vendor: dygma
    socs:
      - name: rp2040
        variants:
          - name: zmk
  - name: defy_right
    full_name: Dygma Defy, right half
    vendor: dygma
    socs:
      - name: rp2040
        variants:
          - name: zmk
```

## boards/dygma/defy_neuron/board.yml
```yaml
# SPDX-License-Identifier: MIT

board:
  name: defy_neuron
  full_name: Dygma Neuron, wireless (nRF52833)
  vendor: dygma
  socs:
    - name: nrf52833
      variants:
        - name: zmk
```

## boards/dygma/defy_rf/Kconfig.defy_rf
```kconfig
# SPDX-License-Identifier: MIT

config BOARD_DEFY_RF
    select SOC_NRF52820_QDAA
```

## boards/dygma/defy_rf/board.yml
```yaml
# SPDX-License-Identifier: MIT

board:
  name: defy_rf
  full_name: Dygma Defy RF board (nRF52820)
  vendor: dygma
  socs:
    - name: nrf52820
```

## bootloader/Kconfig
```kconfig
# SPDX-License-Identifier: MIT

config DEFY_NEURON_BOOTLOADER
    bool "Defy Neuron software bootloader entry"
    default y
    depends on $(dt_nodelabel_enabled,boot_request_partition)
    depends on USB_CDC_ACM && UART_LINE_CTRL
    depends on FLASH && FLASH_MAP && FLASH_PAGE_LAYOUT
    select CDC_ACM_DTE_RATE_CALLBACK_SUPPORT
    select CRC
    select DEFY_UPDATE_GUARD
    help
      Restarts the Neuron into Dygma's n2_bootloader after a 1200-baud
      touch: the host sets a USB serial port other than the half updater's
      to 1200 baud and drops DTR. The Neuron first checks the bootloader's
      CRC32, then writes the bootloader's request page. See
      docs/software-bootloader.md.

config DEFY_UF2_DRIVE
    bool "Defy Neuron key for the UF2 loader's drive"
    default y
    depends on DT_HAS_DYGMA_DEFY_UF2_DRIVE_ENABLED
    depends on RETENTION_BOOT_MODE && ZMK_BOOTMODE_TO_MAGIC_VALUE_MAPPER && REBOOT
    select DEFY_UPDATE_GUARD
    help
      &defy_drive restarts the Neuron into the UF2 loader's drive. ZMK's
      &bootloader would restart the half whose key was pressed. See
      docs/uf2-loader.md.

config DEFY_LOADER_CONFIRM
    bool "Confirm ZMK's starts to the UF2 loader"
    default y
    depends on $(dt_nodelabel_enabled,loader_partition)
    help
      Clears the UF2 loader's count of unconfirmed starts in GPREGRET once
      ZMK has run for 10 s, and before a 1200-baud entry into
      n2_bootloader. After three starts in a row without it, the loader
      shows its drive instead of starting ZMK again. See
      docs/uf2-loader.md.

config DEFY_NEURON_FATAL_RESET
    bool "Restart the Neuron after a fatal error"
    default y
    depends on $(dt_nodelabel_enabled,loader_partition)
    depends on REBOOT
    help
      Zephyr's default handler halts the Neuron after a fatal error, until
      it loses power. This one restarts it, through the UF2 loader, which
      counts the start: a ZMK that fails within 10 s of three starts in a
      row then ends in the loader's drive.

config DEFY_UPDATE_GUARD
    bool
    help
      Lets one of the half updater, the 1200-baud bootloader entry and
      &defy_drive hold the Neuron at a time.
```

## diagnostics/Kconfig
```kconfig
# SPDX-License-Identifier: MIT

config DEFY_FATAL_LEDS
    bool "Show a half's fatal errors on its per-key LEDs"
    default y
    depends on DEFY_RP2040_FACTORY_HANDOFF
    help
      A Zephyr fatal error flashes the per-key LEDs, written through the
      RP2040's registers alone, in a pattern that tells its kind.

config DEFY_FATAL_RECOVERY
    bool "Restart a half after a fatal error and contain repeated faults"
    depends on DEFY_FATAL_LEDS
    default y
    help
      A fatal error shows its pattern for 0.5 s, and the watchdog restarts
      the half 2 s after the fault. The count of quick faults lives in
      watchdog scratch registers 0 and 1 and clears after 60 s of uptime. On
      the third quick fault the half starts with its LEDs off and waits in
      DORMANT until a key is pressed, which starts it afresh. Switching it
      off and on does the same. The -hybrid-diag builds turn this off, so
      that the error stays on the LEDs.

config DEFY_KEY_TRACE
    bool "Trace key events on the Neuron"
    default y
    depends on DEFY_HALF_UPDATER
    help
      Keeps the last 64 steps from a half's frame to a ZMK keycode in RAM:
      the snapshots queued by the hybrid central, the cable frames behind
      them, the position events it publishes and the keycode events ZMK
      raises, each with a microsecond time. The half updater's opcode 11
      reads and clears it; see docs/split-diagnostics.md.
      For finding where keys change order. It takes 768 bytes of RAM.
```

## drivers/Kconfig
```kconfig
# SPDX-License-Identifier: MIT

rsource "bluetooth/Kconfig"
rsource "led_strip/Kconfig"
rsource "split/Kconfig"
rsource "usb/Kconfig"
```

## drivers/bluetooth/Kconfig
```kconfig
# SPDX-License-Identifier: MIT

config DEFY_BT_HCI_SPI
    bool "Bluetooth HCI over SPI to the Defy's nRF52820"
    default y
    depends on DT_HAS_DYGMA_DEFY_BT_HCI_SPI_ENABLED
    depends on BT_HCI && BT_DRIVERS
    select BT_SPI
    select REBOOT
    help
      Zephyr's HCI SPI driver reworked for the Defy: no reset line, limited
      waits, data ready as a level, and power off with the RP2040.

config DEFY_BT_PERSISTENT_ID
    bool "Save the Defy Bluetooth identity before advertising"
    default y
    depends on DEFY_BT_HCI_SPI && BT_SETTINGS && BT_BROADCASTER && !BT_PRIVACY
    help
      Wraps bt_le_adv_start() to save the half's Bluetooth identity to
      settings before it first advertises with it, so that the half keeps
      its address across restarts and the Neuron's bond still fits. The
      wrap also lets half sleep hold off advertising while it shuts
      Bluetooth down.

config DEFY_RADIO_INSTALL
    bool "Install the radio firmware through Dygma's rf_bootloader"
    depends on DEFY_BT_HCI_SPI
    help
      Embeds the nRF52820 firmware from the radio build and, whenever the
      driver starts the radio, checks it in Dygma's rf_bootloader and
      installs it there if the radio holds anything else, as Dygma's
      keyscanner installs its own radio application. The build needs
      DEFY_RADIO_IMAGE_SOURCE, the C file scripts/package_radio.py writes;
      scripts/build passes it.
```

## drivers/led_strip/Kconfig
```kconfig
# SPDX-License-Identifier: MIT

config IS31FL3743B
    bool "ISSI IS31FL3743B LED matrix driver"
    default y
    depends on DT_HAS_ISSI_IS31FL3743B_ENABLED
    depends on LED_STRIP
    select SPI
    help
      LED strip driver for the IS31FL3743B on SPI, used for the Defy's
      per-key LEDs.

config DEFY_LEDS
    bool "Dygma Defy lights as one LED strip"
    default y
    depends on DT_HAS_DYGMA_DEFY_LEDS_ENABLED
    depends on LED_STRIP
    help
      Joins the Defy's per-key LEDs and underglow into one strip, and
      switches the underglow's supply.

config DEFY_WS2812_PIO
    bool "WS2812 on the RP2040's PIO, Zephyr's driver with four fixes"
    default y
    depends on DT_HAS_DYGMA_WS2812_RPI_PICO_PIO_ENABLED
    depends on LED_STRIP
    select PICOSDK_USE_PIO
    help
      A copy of Zephyr 4.1's WS2812 PIO driver for the Defy's underglow. It
      packs four-channel pixels from the top byte, runs the PIO program at
      whatever offset it was loaded, keeps the clock divider's fraction and
      checks that the program fits. The driver's source describes each fix.
```
