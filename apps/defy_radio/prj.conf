## CMakeLists.txt
```
# SPDX-License-Identifier: MIT

cmake_minimum_required(VERSION 3.20.0)

find_package(Zephyr REQUIRED HINTS $ENV{ZEPHYR_BASE})
project(defy_radio)

get_filename_component(module ${CMAKE_CURRENT_LIST_DIR}/../.. ABSOLUTE)
include(${module}/cmake/defy_upstream.cmake)
# src/startup.c replaces the soc_reset_hook binding, as the UF2 loader's start.c does.
defy_upstream_pin(${ZEPHYR_BASE}/soc/nordic/common/platform_init.ld
                  2e75270bf5d0bfbcefe237fb653c8c4a975bf787b9f60406268f4a7f0cc7279c
                  "the radio's src/startup.c")
defy_upstream_pin(${ZEPHYR_BASE}/arch/arm/core/cortex_m/reset.S
                  3245028db3c46e9ed273d4e981f1776d7d1741a02d1fbda7d18617a81e82e74c
                  "the radio's src/startup.c")

target_include_directories(app PRIVATE src)
target_sources(app PRIVATE src/main.c src/link.c src/power_off.c src/watchdog.c src/fatal.c src/boot.c src/startup.c)
target_sources(app PRIVATE src/battery.c src/battery_hci.c src/battery_trace.c
  src/battery_comp.c src/battery_filter.c src/charger.c ../../battery/defy_battery_protocol.c)
zephyr_link_libraries(-Wl,--wrap=nrfx_twim_init)
defy_upstream_uses(${ZEPHYR_BASE}/drivers/i2c/i2c_nrfx_twim_common.c
                   "the I2C trace's wrap in src/battery_trace.c" "nrfx_twim_init(")
```

## prj.conf
```kconfig
# SPDX-License-Identifier: MIT

# Bluetooth controller for the RP2040, over SPI.
CONFIG_GPIO=y
CONFIG_SPI=y
CONFIG_SPI_ASYNC=y
CONFIG_SPI_SLAVE=y
CONFIG_MAIN_STACK_SIZE=512

CONFIG_BT=y
CONFIG_BT_HCI_RAW=y

# A half is a peripheral of the Neuron, with one connection, as the RP2040's
# host is configured. That keeps the image inside the stock application slot,
# 0x1C000 to 0x39000.
CONFIG_BT_MAX_CONN=1
CONFIG_BT_CENTRAL=n
CONFIG_BT_OBSERVER=n
CONFIG_BT_CTLR_PHY_CODED=n
CONFIG_BT_CTLR_PRIVACY=n

# Nothing reads logs without SWD.
CONFIG_LOG=n

# The vendor reboot and power-off commands.
CONFIG_REBOOT=y
CONFIG_POWEROFF=y

# Battery gauge, charger and comparator. A stuck I2C transfer gives up after
# 20 ms rather than the driver's default 500 ms: power-off waits for a sample
# in progress.
CONFIG_I2C=y
CONFIG_I2C_NRFX_TRANSFER_TIMEOUT=20
```

## src/main.c
```c
/*
 * Copyright (c) 2017 Linaro Limited
 * Copyright (c) 2016 Nordic Semiconductor ASA
 * Copyright (c) 2015-2016 Intel Corporation
 *
 * SPDX-License-Identifier: Apache-2.0
 */

/*
 * Bluetooth controller for a Defy half's RP2040, over SPI. Based on Zephyr's
 * samples/bluetooth/hci_spi, with its two-thread transfer handshake replaced
 * by one thread around link.c, which tests/drivers/defy_hci_spi runs against
 * the RP2040's driver. Besides that:
 *
 * - The ready event is queued before the link starts, so the host never finds
 *   this radio empty before reading it.
 * - Data ready stays high while any message is unsent.
 * - It takes vendor commands of its own: reboot, power off to System OFF,
 *   from which chip select going low wakes it, and a battery refresh.
 * - It queues battery samples for the host, through battery_hci.c.
 */

#include <errno.h>

#include <zephyr/bluetooth/buf.h>
#include <zephyr/bluetooth/hci.h>
#include <zephyr/bluetooth/hci_raw.h>
#include <zephyr/drivers/gpio.h>
#include <zephyr/drivers/spi.h>
#include <zephyr/kernel.h>
#include <zephyr/logging/log.h>
#include <zephyr/sys/reboot.h>

#include <dygma/defy_hci_spi.h>

#include "battery.h"
#include "bridge.h"
#include "link.h"
#include "power_off.h"
#include "watchdog.h"

LOG_MODULE_REGISTER(defy_radio, LOG_LEVEL_INF);

/* The link thread's heartbeat while it waits for the host to clock a transfer. */
#define LINK_WAIT_TIMEOUT_MS 100
/*
 * Cooperative, as in Zephyr's hci_spi sample: main() and the battery queue,
 * both preemptible, never interrupt it between arming a reply and starting
 * the transfer.
 */
#define LINK_THREAD_PRIORITY K_PRIO_COOP(7)
/* Command Complete with a status, the longest of the radio's own events. */
#define CONTROL_EVENT_MAX 6

static const struct device *const spi_dev = DEVICE_DT_GET(DEFY_RADIO_SPI_NODE);
static const struct spi_config spi_cfg = {
    .operation = SPI_WORD_SET(8) | SPI_OP_MODE_SLAVE,
};
static const struct gpio_dt_spec data_ready = GPIO_DT_SPEC_GET(DEFY_RADIO_HCI_NODE, irq_gpios);
const struct gpio_dt_spec defy_radio_chip_select =
    GPIO_DT_SPEC_GET(DT_PATH(zephyr_user), chip_select_gpios);

static K_FIFO_DEFINE(controller_queue);

/* Messages for the host, with their H4 packet type, oldest first. */
static K_FIFO_DEFINE(host_queue);
static struct k_spinlock host_queue_lock;

static uint8_t tx[DEFY_HCI_SPI_MAX_MSG_LEN];
static uint8_t rx[DEFY_HCI_SPI_MAX_MSG_LEN];

static K_THREAD_STACK_DEFINE(link_stack, CONFIG_BT_HCI_TX_STACK_SIZE);
static struct k_thread link_thread_data;

NET_BUF_POOL_FIXED_DEFINE(control_pool, 2, BT_BUF_RESERVE + CONTROL_EVENT_MAX,
                          sizeof(struct bt_buf_data), NULL);

static bool power_off_requested;
static int64_t power_off_deadline;
static K_SEM_DEFINE(spi_done, 0, 1);
static int spi_result;

void defy_radio_queue_for_host(struct net_buf *buf, bool control) {
    k_spinlock_key_t key;

    switch (bt_buf_get_type(buf)) {
    case BT_BUF_ACL_IN:
        net_buf_push_u8(buf, BT_HCI_H4_ACL);
        break;
    case BT_BUF_EVT:
        net_buf_push_u8(buf, BT_HCI_H4_EVT);
        break;
    default:
        LOG_ERR("Unknown buffer type %u", bt_buf_get_type(buf));
        net_buf_unref(buf);
        return;
    }

    if (buf->len > DEFY_HCI_SPI_MAX_MSG_LEN) {
        LOG_ERR("Message of %u bytes is too long", buf->len);
        net_buf_unref(buf);
        return;
    }

    key = k_spin_lock(&host_queue_lock);
    if (power_off_requested && !control) {
        k_spin_unlock(&host_queue_lock, key);
        net_buf_unref(buf);
        return;
    }
    k_fifo_put(&host_queue, buf);
    gpio_pin_set_dt(&data_ready, 1);
    k_spin_unlock(&host_queue_lock, key);
}

/* Queues an HCI event of the radio's own, without its H4 packet type. */
static void queue_event(const uint8_t *event, size_t len) {
    struct net_buf *buf = net_buf_alloc(&control_pool, K_NO_WAIT);

    if (buf == NULL) {
        LOG_ERR("No buffer for a control event");
        return;
    }
    net_buf_reserve(buf, BT_BUF_RESERVE);
    bt_buf_set_type(buf, BT_BUF_EVT);
    net_buf_add_mem(buf, event, len);
    defy_radio_queue_for_host(buf, true);
}

/* Drops the oldest message, which the host has read. */
static void sent(void) {
    k_spinlock_key_t key = k_spin_lock(&host_queue_lock);
    struct net_buf *buf = k_fifo_get(&host_queue, K_NO_WAIT);

    if (k_fifo_is_empty(&host_queue)) {
        gpio_pin_set_dt(&data_ready, 0);
    }
    k_spin_unlock(&host_queue_lock, key);

    net_buf_unref(buf);
    defy_radio_battery_hci_sent();
}

static void to_controller(const uint8_t *packet, size_t len) {
    enum bt_buf_type type = packet[0] == BT_HCI_H4_CMD ? BT_BUF_CMD : BT_BUF_ACL_OUT;
    struct net_buf *buf = bt_buf_get_tx(type, K_NO_WAIT, &packet[1], len - 1);
    int err;

    if (buf == NULL) {
        LOG_ERR("No buffer for a packet from the host");
        return;
    }

    err = bt_send(buf);
    if (err < 0) {
        LOG_ERR("Controller refused a packet (%d)", err);
        net_buf_unref(buf);
    }
}

static void request_power_off(void) {
    static const uint8_t reply[] =
        DEFY_HCI_SPI_COMMAND_COMPLETE(DEFY_HCI_SPI_OP_POWER_OFF, BT_HCI_ERR_SUCCESS);
    k_spinlock_key_t key = k_spin_lock(&host_queue_lock);

    if (power_off_requested) {
        k_spin_unlock(&host_queue_lock, key);
        return;
    }
    defy_radio_battery_hci_power_off();
    power_off_deadline = k_uptime_get() + DEFY_HCI_SPI_POWER_OFF_RADIO_TIMEOUT_MS;
    power_off_requested = true;
    k_spin_unlock(&host_queue_lock, key);
    queue_event(reply, sizeof(reply));
}

static void spi_complete(const struct device *dev, int result, void *userdata) {
    ARG_UNUSED(dev);
    ARG_UNUSED(userdata);

    spi_result = result;
    k_sem_give(&spi_done);
}

static FUNC_NORETURN void finish_power_off(void) {
    defy_radio_battery_stop();
    gpio_pin_set_dt(&data_ready, 0);
    while (true) {
        /* -EBUSY until the RP2040 lets go of chip select. */
        (void)defy_radio_power_off();
        k_sleep(K_MSEC(1));
    }
}

static void link_thread(void *p1, void *p2, void *p3) {
    struct defy_link link;

    ARG_UNUSED(p1);
    ARG_UNUSED(p2);
    ARG_UNUSED(p3);

    defy_link_init(&link);

    while (true) {
        defy_radio_watchdog_heartbeat();
        if (power_off_requested &&
            (k_fifo_is_empty(&host_queue) || k_uptime_get() >= power_off_deadline)) {
            finish_power_off();
        }

        struct net_buf *oldest = k_fifo_peek_head(&host_queue);
        const struct spi_buf tx_buf = {
            .buf = tx,
            .len = defy_link_arm(&link, oldest != NULL ? oldest->data : NULL,
                                 oldest != NULL ? oldest->len : 0, tx),
        };
        const struct spi_buf rx_buf = {.buf = rx, .len = sizeof(rx)};
        const struct spi_buf_set tx_set = {.buffers = &tx_buf, .count = 1};
        const struct spi_buf_set rx_set = {.buffers = &rx_buf, .count = 1};

        if (link.phase == DEFY_LINK_SEND && oldest != NULL) {
            defy_radio_battery_hci_arm(oldest, tx);
        }
        int err = spi_transceive_cb(spi_dev, &spi_cfg, &tx_set, &rx_set, spi_complete, NULL);

        if (err < 0) {
            LOG_ERR("SPI transfer failed (%d)", err);
            k_sleep(K_MSEC(1));
            continue;
        }

        while (true) {
            int64_t wait_deadline = k_uptime_get() + LINK_WAIT_TIMEOUT_MS;

            if (power_off_requested && power_off_deadline < wait_deadline) {
                wait_deadline = power_off_deadline;
            }
            if (k_sem_take(&spi_done, K_TIMEOUT_ABS_MS(wait_deadline)) == 0) {
                break;
            }
            defy_radio_watchdog_heartbeat();
            if (power_off_requested && k_uptime_get() >= power_off_deadline) {
                finish_power_off();
            }
        }
        if (spi_result < 0) {
            LOG_ERR("SPI transfer failed (%d)", spi_result);
            continue;
        }

        switch (defy_link_done(&link, rx, spi_result)) {
        case DEFY_LINK_SENT:
            sent();
            break;
        case DEFY_LINK_PACKET:
            to_controller(rx, link.packet_len);
            break;
        case DEFY_LINK_REBOOT:
            sys_reboot(SYS_REBOOT_COLD);
            break;
        case DEFY_LINK_POWER_OFF:
            request_power_off();
            break;
        case DEFY_LINK_BATTERY_REFRESH: {
            const uint8_t reply[] = DEFY_HCI_SPI_COMMAND_COMPLETE(
                DEFY_HCI_SPI_OP_BATTERY_REFRESH, defy_radio_battery_hci_refresh());

            queue_event(reply, sizeof(reply));
            break;
        }
        case DEFY_LINK_NONE:
            break;
        }
    }
}

int main(void) {
    static const uint8_t ready[] = DEFY_HCI_SPI_READY_EVENT;
    int err;

    if (!device_is_ready(spi_dev) || !gpio_is_ready_dt(&data_ready) ||
        !gpio_is_ready_dt(&defy_radio_chip_select)) {
        LOG_ERR("SPI or GPIO not ready");
        return 0;
    }

    gpio_pin_configure_dt(&data_ready, GPIO_OUTPUT_INACTIVE);

    err = bt_enable_raw(&controller_queue);
    if (err < 0) {
        LOG_ERR("bt_enable_raw failed (%d)", err);
        return 0;
    }

    /* Before the link starts, so the first header the host reads from this boot has it. */
    queue_event(ready, sizeof(ready));
    defy_radio_battery_start();

    k_thread_create(&link_thread_data, link_stack, K_THREAD_STACK_SIZEOF(link_stack), link_thread,
                    NULL, NULL, NULL, LINK_THREAD_PRIORITY, 0, K_NO_WAIT);
    k_thread_name_set(&link_thread_data, "link");

    while (true) {
        defy_radio_queue_for_host(k_fifo_get(&controller_queue, K_FOREVER), false);
    }

    return 0;
}
```

## src/battery.c
```c
/*
 * Samples the battery gauge, or the comparator on a half without one, and
 * the charger, and publishes the samples for the host.
 *
 * SPDX-License-Identifier: MIT
 */

#include <errno.h>
#include <string.h>

#include <zephyr/device.h>
#include <zephyr/drivers/i2c.h>
#include <zephyr/kernel.h>
#include <zephyr/sys/atomic.h>
#include <zephyr/sys/byteorder.h>

#include "battery.h"
#include "battery_comp.h"
#include "battery_filter.h"
#include "battery_trace.h"
#include "charger.h"

#define BATTERY_ADDRESS 0x36
#define BATTERY_START_DELAY_MS 1000
#define BATTERY_SAMPLE_INTERVAL_MS 30000
#define BATTERY_POWERED_INTERVAL_MS 5000
#define BATTERY_BURST_INTERVAL_MS 500
#define BATTERY_BURST_SAMPLES 5
/*
 * Republish an unchanged sample before the last published one gets older than
 * this: about once a minute when settled. Copies on the halves and the Neuron
 * then stay under DEFY_BATTERY_MAX_AGE_MS even after the Neuron's 15 s poll.
 */
#define BATTERY_REPUBLISH_MS 65000
#define BATTERY_STACK_SIZE 1024
/* Preemptible, below the radio's cooperative link thread. */
#define BATTERY_QUEUE_PRIORITY 5
/* The charger's words, from DEFY_BATTERY_ANALOG_CHARGER to the end of the sample. */
#define CHARGER_WORDS (DEFY_BATTERY_WORD_COUNT - DEFY_BATTERY_ANALOG_CHARGER)

static const struct device *const battery_bus = DEVICE_DT_GET(DT_NODELABEL(i2c1));
static const uint8_t battery_registers[DEFY_BATTERY_WORD_COUNT] = {
    [DEFY_BATTERY_DEVNAME] = 0x21,
    [DEFY_BATTERY_STATUS] = 0x00,
    [DEFY_BATTERY_FSTAT] = 0x3d,
    [DEFY_BATTERY_MODELCFG] = 0xdb,
    [DEFY_BATTERY_REPSOC] = 0x06,
    [DEFY_BATTERY_VCELL] = 0x09,
    [DEFY_BATTERY_CURRENT] = 0x0a,
    [DEFY_BATTERY_DESIGNCAP] = 0x18,
};
static const uint8_t charger_registers[DEFY_BATTERY_CHARGER_REGISTER_COUNT] = {
    [DEFY_BATTERY_CHARGER_ID] = DEFY_CHARGER_REG_ID,
    [DEFY_BATTERY_CHARGER_STATUS] = DEFY_CHARGER_REG_STATUS,
    [DEFY_BATTERY_CHARGER_CONTROL] = DEFY_CHARGER_REG_CONTROL,
    [DEFY_BATTERY_CHARGER_VOLTAGE] = DEFY_CHARGER_REG_VOLTAGE,
    [DEFY_BATTERY_CHARGER_CURRENT] = DEFY_CHARGER_REG_CURRENT,
    [DEFY_BATTERY_CHARGER_SPECIAL] = DEFY_CHARGER_REG_SPECIAL,
    [DEFY_BATTERY_CHARGER_SAFETY] = DEFY_CHARGER_REG_SAFETY,
};

static K_THREAD_STACK_DEFINE(battery_stack, BATTERY_STACK_SIZE);
static struct k_work_q battery_queue;
static atomic_t battery_started;
static atomic_t battery_stopping;
static atomic_t battery_burst;
static atomic_t battery_forced;
static uint32_t battery_sequence;
static bool battery_analog_selected;
static bool charger_status_valid;
static uint8_t charger_status;
static struct defy_battery_filter battery_filter;
static struct defy_battery_sample battery_published;
static bool battery_published_valid;
static int64_t battery_published_at;

static void battery_work_handler(struct k_work *work);
static K_WORK_DELAYABLE_DEFINE(battery_work, battery_work_handler);

static void charger_work_handler(struct k_work *work);
static K_WORK_DELAYABLE_DEFINE(charger_work, charger_work_handler);

int defy_radio_battery_refresh(void) {
    if (!atomic_get(&battery_started) || atomic_get(&battery_stopping)) {
        return -ESHUTDOWN;
    }
    atomic_set(&battery_burst, BATTERY_BURST_SAMPLES);
    atomic_set(&battery_forced, 1);
    k_work_reschedule_for_queue(&battery_queue, &battery_work, K_NO_WAIT);
    return 0;
}

static void charger_work_handler(struct k_work *work) {
    ARG_UNUSED(work);

    if (atomic_get(&battery_stopping)) {
        return;
    }
    int err = defy_radio_charger_service(battery_bus);
    uint8_t status = 0;
    if (err == 0) {
        uint8_t reg = DEFY_CHARGER_REG_STATUS;
        defy_battery_trace_begin();
        err = i2c_write_read(battery_bus, DEFY_CHARGER_ADDRESS, &reg, 1, &status, 1);
    }
    status &= 0x3f;
    bool changed = charger_status_valid != (err == 0) ||
                   (err == 0 && status != charger_status);
    charger_status_valid = err == 0;
    charger_status = status;
    if (changed) {
        defy_radio_battery_refresh();
    }
    if (!atomic_get(&battery_stopping)) {
        k_work_schedule_for_queue(&battery_queue, &charger_work,
                                  K_MSEC(DEFY_CHARGER_SERVICE_INTERVAL_MS));
    }
}

static void charger_read_diagnostic(const struct device *bus,
                                    struct defy_battery_sample *sample) {
    uint8_t reg = DEFY_CHARGER_REG_ID;
    uint8_t value = 0;
    defy_battery_trace_begin();
    uint32_t started = k_cycle_get_32();
    int err = i2c_write_read(bus, DEFY_CHARGER_ADDRESS, &reg, sizeof(reg), &value, sizeof(value));
    uint32_t elapsed = k_cyc_to_us_floor64((uint32_t)(k_cycle_get_32() - started));
    defy_battery_trace_charger(sample, reg, err, value, elapsed);
}

/*
 * Reads the gauge into sample. True if the half has no gauge, from an address
 * NACK or another device's DevName, so the comparator takes over.
 */
static bool battery_gauge_read(const struct device *bus, struct defy_battery_sample *sample) {
    if (!device_is_ready(bus)) {
        sample->status = DEFY_BATTERY_SAMPLE_NO_DEVICE;
        return false;
    }

    for (size_t i = 0; i < ARRAY_SIZE(battery_registers); i++) {
        uint8_t reg = battery_registers[i];
        uint8_t bytes[2];
        defy_battery_trace_begin();
        uint32_t started = k_cycle_get_32();
        int err = i2c_write_read(bus, BATTERY_ADDRESS, &reg, sizeof(reg), bytes, sizeof(bytes));

        if (err < 0) {
            uint32_t elapsed = k_cyc_to_us_floor64((uint32_t)(k_cycle_get_32() - started));
            defy_battery_trace_error(sample, reg, err, elapsed);
            bool address_nack = defy_battery_trace_tx_address_nack(sample);
            if (address_nack) {
                charger_read_diagnostic(bus, sample);
            }
            return i == DEFY_BATTERY_DEVNAME && address_nack;
        }
        sample->words[i] = sys_get_le16(bytes);
        if (i == DEFY_BATTERY_DEVNAME && sample->words[i] != DEFY_BATTERY_GAUGE_DEVNAME) {
            sample->status = DEFY_BATTERY_SAMPLE_NO_DEVICE;
            return true;
        }
    }
    return false;
}

static void charger_read(const struct device *bus, struct defy_battery_sample *sample) {
    memset(&sample->words[DEFY_BATTERY_ANALOG_CHARGER], 0,
           CHARGER_WORDS * sizeof(sample->words[0]));
    if (!device_is_ready(bus)) {
        return;
    }
    for (size_t i = 0; i < ARRAY_SIZE(charger_registers); i++) {
        uint8_t reg = charger_registers[i];
        uint8_t value = 0;
        defy_battery_trace_begin();
        int err = i2c_write_read(bus, DEFY_CHARGER_ADDRESS, &reg, 1, &value, 1);
        if (err != 0) {
            return;
        }
        sample->words[DEFY_BATTERY_ANALOG_CHARGER + i / 2] |= (uint16_t)value << (8 * (i % 2));
        sample->words[DEFY_BATTERY_ANALOG_CHARGER_VALID] |= (uint16_t)(1u << i) << 8;
        if (i == DEFY_BATTERY_CHARGER_ID &&
            (value & DEFY_BATTERY_CHARGER_ID_MASK) != DEFY_BATTERY_CHARGER_ID_VALUE) {
            return;
        }
    }
}

static void battery_read(const struct device *bus, struct defy_battery_sample *sample) {
    if (!battery_analog_selected) {
        battery_analog_selected = battery_gauge_read(bus, sample);
        if (!battery_analog_selected) {
            return;
        }
    }

    struct defy_battery_comp_reading analog;
    int err = defy_radio_battery_comp_read(&analog);
    uint16_t millivolts;
    if (err == 0) {
        err = defy_battery_analog_mv(analog.threshold, analog.reference, &millivolts);
    }
    memset(sample->words, 0, sizeof(sample->words));
    sample->words[DEFY_BATTERY_ANALOG_FORMAT] = DEFY_BATTERY_ANALOG_CHARGER_TAG;
    if (err != 0) {
        sample->status = DEFY_BATTERY_SAMPLE_ANALOG_ERROR;
        sample->words[DEFY_BATTERY_ANALOG_ERRNO] = (uint16_t)err;
    } else {
        sample->status = DEFY_BATTERY_SAMPLE_ANALOG_OK;
        sample->words[DEFY_BATTERY_ANALOG_THRESHOLD] = analog.threshold;
        sample->words[DEFY_BATTERY_ANALOG_REFERENCE] = analog.reference;
        sample->words[DEFY_BATTERY_ANALOG_MILLIVOLTS] = millivolts;
    }
    charger_read(bus, sample);
}

/*
 * A filtered analog sample compares the estimate, not the raw threshold, which
 * can dither between adjacent steps.
 */
static bool battery_changed(const struct defy_battery_sample *sample) {
    const struct defy_battery_sample *last = &battery_published;

    if (!battery_published_valid || sample->status != last->status ||
        sample->words[DEFY_BATTERY_ANALOG_FORMAT] != last->words[DEFY_BATTERY_ANALOG_FORMAT]) {
        return true;
    }
    if (sample->status == DEFY_BATTERY_SAMPLE_ANALOG_OK &&
        sample->words[DEFY_BATTERY_ANALOG_FORMAT] == DEFY_BATTERY_ANALOG_FILTERED_TAG) {
        return (sample->words[DEFY_BATTERY_ANALOG_THRESHOLD] >> 8) !=
                   (last->words[DEFY_BATTERY_ANALOG_THRESHOLD] >> 8) ||
               memcmp(&sample->words[DEFY_BATTERY_ANALOG_CHARGER],
                      &last->words[DEFY_BATTERY_ANALOG_CHARGER],
                      CHARGER_WORDS * sizeof(sample->words[0])) != 0;
    }
    return memcmp(sample->words, last->words, sizeof(sample->words)) != 0;
}

static uint32_t next_delay(void) {
    if (atomic_get(&battery_burst) > 0) {
        return BATTERY_BURST_INTERVAL_MS;
    }
    if (battery_analog_selected) {
        return defy_battery_filter_delay(&battery_filter);
    }
    return charger_status_valid && charger_status != 0 &&
                   charger_status != DEFY_BATTERY_CHARGER_FAULT_SLEEP
               ? BATTERY_POWERED_INTERVAL_MS
               : BATTERY_SAMPLE_INTERVAL_MS;
}

static void battery_work_handler(struct k_work *work) {
    ARG_UNUSED(work);

    if (atomic_get(&battery_stopping)) {
        return;
    }
    if (atomic_get(&battery_burst) > 0) {
        atomic_dec(&battery_burst);
    }
    bool forced = atomic_clear(&battery_forced);
    if (++battery_sequence == 0) {
        battery_sequence = 1;
    }
    struct defy_battery_sample sample = {.sequence = battery_sequence};
    int64_t now = k_uptime_get();

    battery_read(battery_bus, &sample);
    defy_battery_filter_apply(&battery_filter, &sample, now);
    uint32_t delay = next_delay();
    /* Publish only news, a refresh, or a sample the next one would leave too old. */
    if (forced || battery_changed(&sample) ||
        now + delay - battery_published_at > BATTERY_REPUBLISH_MS) {
        int err = defy_radio_battery_publish(&sample);

        if (err == -ESHUTDOWN) {
            return;
        }
        battery_published_valid = err == 0;
        if (err == 0) {
            battery_published = sample;
            battery_published_at = now;
        }
    }
    if (!atomic_get(&battery_stopping)) {
        k_work_schedule_for_queue(&battery_queue, &battery_work, K_MSEC(delay));
    }
}

void defy_radio_battery_start(void) {
    if (!atomic_cas(&battery_started, 0, 1)) {
        return;
    }
    k_work_queue_start(&battery_queue, battery_stack, K_THREAD_STACK_SIZEOF(battery_stack),
                       BATTERY_QUEUE_PRIORITY, NULL);
    k_work_schedule_for_queue(&battery_queue, &charger_work, K_MSEC(BATTERY_START_DELAY_MS));
    k_work_schedule_for_queue(&battery_queue, &battery_work, K_MSEC(BATTERY_START_DELAY_MS));
}

void defy_radio_battery_stop(void) {
    struct k_work_sync sync;

    atomic_set(&battery_stopping, 1);
    k_work_cancel_delayable_sync(&charger_work, &sync);
    k_work_cancel_delayable_sync(&battery_work, &sync);
}
```

## src/battery.h
```c
/*
 * Battery support on the radio. battery.c samples the battery gauge, or the
 * comparator on a half without one, and the charger. battery_hci.c hands each
 * sample to the host as a vendor event (dygma/defy_battery_hci.h).
 *
 * SPDX-License-Identifier: MIT
 */

#ifndef DEFY_RADIO_BATTERY_H
#define DEFY_RADIO_BATTERY_H

#include <stdint.h>

#include <zephyr/net_buf.h>

#include <dygma/defy_battery.h>

/* battery.c: sampling, from the radio's start until it powers off. */
void defy_radio_battery_start(void);
void defy_radio_battery_stop(void);

/* battery.c: a burst of samples, the first now. -ESHUTDOWN before start or once stopping. */
int defy_radio_battery_refresh(void);

/* battery_hci.c: queues sample for the host. -ESHUTDOWN once the radio is powering off. */
int defy_radio_battery_publish(const struct defy_battery_sample *sample);

/* battery_hci.c: the host has read a message, which may free the buffer for a waiting sample. */
void defy_radio_battery_hci_sent(void);

/* battery_hci.c: the radio is powering off. A waiting sample is dropped, and no more taken. */
void defy_radio_battery_hci_power_off(void);

/*
 * battery_hci.c: if buf is the battery event, updates the age in message, the
 * copy of buf armed for the host.
 */
void defy_radio_battery_hci_arm(const struct net_buf *buf, uint8_t *message);

/* battery_hci.c: the refresh command. Asks battery.c for a sample now; returns the reply status. */
uint8_t defy_radio_battery_hci_refresh(void);

#endif
```

## src/battery_comp.c
```c
/*
 * The battery voltage from the nRF52820's comparator, on a half whose gauge
 * does not answer. The battery, divided down, is on AIN1. A sweep tries the
 * 64 thresholds from the top against the internal 2.4 V reference, and
 * against VDD if the input is above all of them; the first threshold the
 * input is above is the reading. The registers are driven through nrfy,
 * with Zephyr's comparator drivers off. Stopping the comparator applies
 * erratum 275's workaround on the nRF52820 builds it affects.
 *
 * SPDX-License-Identifier: MIT
 */

#include <errno.h>
#include <haly/nrfy_comp.h>
#include <zephyr/kernel.h>
#include <zephyr/sys/sys_io.h>

#include "battery_comp.h"

#define COMP_READY_TIMEOUT_US 1000u
/* TH is six bits. */
#define COMP_THRESHOLD_MAX 63
#define COMP_ERRATA_275_RESET 0x40013ffcu
#define FICR_VARIANT_BUILD_MASK 0x0000ff00u

BUILD_ASSERT(!IS_ENABLED(CONFIG_NRFX_COMP));
BUILD_ASSERT(!IS_ENABLED(CONFIG_COMPARATOR));

static bool comp_errata_275(void) {
    uint32_t build = NRF_FICR->INFO.VARIANT & FICR_VARIANT_BUILD_MASK;
    return NRF_FICR->INFO.PART == FICR_INFO_PART_PART_N52820 &&
           (build == (FICR_INFO_VARIANT_VARIANT_AAC0 & FICR_VARIANT_BUILD_MASK) ||
            build == (FICR_INFO_VARIANT_VARIANT_AAD0 & FICR_VARIANT_BUILD_MASK));
}

static void comp_stop(void) {
    nrfy_comp_task_trigger(NRF_COMP, NRF_COMP_TASK_STOP);
    nrfy_comp_disable(NRF_COMP);
    if (comp_errata_275()) {
        sys_write32(0, COMP_ERRATA_275_RESET);
        (void)sys_read32(COMP_ERRATA_275_RESET);
        sys_write32(1, COMP_ERRATA_275_RESET);
    }
}

static int comp_trial(uint8_t threshold, nrf_comp_ref_t reference) {
    nrfy_comp_config_t config = {
        .reference = reference,
        .main_mode = NRF_COMP_MAIN_MODE_SE,
        .threshold = {.th_down = threshold, .th_up = threshold},
        .speed_mode = NRF_COMP_SP_MODE_NORMAL,
        .hyst = NRF_COMP_HYST_NO_HYST,
        .input = NRF_COMP_INPUT_1,
    };

    nrfy_comp_periph_configure(NRF_COMP, &config);
    nrfy_comp_enable(NRF_COMP);
    nrfy_comp_task_trigger(NRF_COMP, NRF_COMP_TASK_STOP);
    nrfy_comp_event_clear(NRF_COMP, NRF_COMP_EVENT_READY);
    nrfy_comp_event_clear(NRF_COMP, NRF_COMP_EVENT_DOWN);
    nrfy_comp_event_clear(NRF_COMP, NRF_COMP_EVENT_UP);
    nrfy_comp_event_clear(NRF_COMP, NRF_COMP_EVENT_CROSS);
    uint32_t started = k_cycle_get_32();
    nrfy_comp_task_trigger(NRF_COMP, NRF_COMP_TASK_START);

    int result = -ETIMEDOUT;
    while (!nrfy_comp_event_check(NRF_COMP, NRF_COMP_EVENT_READY)) {
        if (k_cyc_to_us_floor64((uint32_t)(k_cycle_get_32() - started)) >=
            COMP_READY_TIMEOUT_US) {
            goto done;
        }
        k_busy_wait(1);
    }
    result = nrfy_comp_sample(NRF_COMP);

done:
    comp_stop();
    return result;
}

static int comp_sweep(nrf_comp_ref_t reference, uint8_t *threshold) {
    for (int value = COMP_THRESHOLD_MAX;; value--) {
        int above = comp_trial(value, reference);

        if (above < 0) {
            return above;
        }
        if (above || value == 0) {
            *threshold = value;
            return 0;
        }
    }
}

int defy_radio_battery_comp_read(struct defy_battery_comp_reading *out) {
    nrfy_comp_int_disable(NRF_COMP, UINT32_MAX);
    nrfy_comp_shorts_disable(NRF_COMP, UINT32_MAX);
    comp_stop();
    struct defy_battery_comp_reading reading = {
        .reference = DEFY_BATTERY_ANALOG_REFERENCE_2V4,
    };
    int err = comp_sweep(NRF_COMP_REF_INT_2V4, &reading.threshold);
    if (err) {
        return err;
    }
    if (reading.threshold == COMP_THRESHOLD_MAX) {
        reading.reference = DEFY_BATTERY_ANALOG_REFERENCE_VDD;
        err = comp_sweep(NRF_COMP_REF_VDD, &reading.threshold);
        if (err) {
            return err;
        }
    }
    *out = reading;
    return 0;
}
```

## src/battery_comp.h
```c
/*
 * The battery voltage from the comparator: battery_comp.c.
 *
 * SPDX-License-Identifier: MIT
 */

#ifndef DEFY_RADIO_BATTERY_COMP_H
#define DEFY_RADIO_BATTERY_COMP_H

#include <stdint.h>

#include <dygma/defy_battery.h>

struct defy_battery_comp_reading {
    uint8_t threshold;
    /* DEFY_BATTERY_ANALOG_REFERENCE_2V4 or DEFY_BATTERY_ANALOG_REFERENCE_VDD. */
    uint8_t reference;
};

int defy_radio_battery_comp_read(struct defy_battery_comp_reading *out);

#endif
```

## src/battery_filter.c
```c
/*
 * The battery level estimate from comparator samples, which battery.c applies
 * to every sample before publishing it. docs/battery.md describes it under
 * "Persistent analogue estimate".
 *
 * SPDX-License-Identifier: MIT
 */

#include <string.h>

#include "battery_filter.h"

static uint8_t filter_reading(struct defy_battery_filter *filter,
                              const struct defy_battery_reading *reading, int64_t now) {
    if (filter->count &&
        (now < filter->sampled_at || now - filter->sampled_at > DEFY_BATTERY_FILTER_GAP_MS)) {
        memset(filter, 0, sizeof(*filter));
    }
    if (filter->count && now - filter->sampled_at < DEFY_BATTERY_FILTER_INTERVAL_MS) {
        return filter->valid ? filter->level : DEFY_BATTERY_LEVEL_UNAVAILABLE;
    }
    if (!filter->count) {
        filter->started_at = now;
    }
    filter->millivolts[filter->next] = reading->millivolts;
    filter->levels[filter->next] = reading->level;
    filter->next = (filter->next + 1u) % DEFY_BATTERY_FILTER_SAMPLES;
    if (filter->count < DEFY_BATTERY_FILTER_SAMPLES) {
        filter->count++;
    }
    filter->sampled_at = now;

    uint8_t best = 0;
    uint8_t votes = 0;
    uint8_t held = 0;
    for (uint8_t i = 0; i < filter->count; i++) {
        uint8_t count = 0;
        for (uint8_t j = 0; j < filter->count; j++) {
            count += filter->millivolts[j] == filter->millivolts[i];
        }
        if (filter->valid && filter->millivolts[i] == filter->estimate_mv) {
            held = count;
        }
        if (count > votes ||
            (count == votes && filter->millivolts[i] < filter->millivolts[best])) {
            best = i;
            votes = count;
        }
    }
    /*
     * The most frequent voltage wins, ties going to the lower one. A higher
     * voltage must also outnumber the held estimate two to one, so a reading
     * that dithers between adjacent thresholds settles on the lower one
     * instead of alternating.
     */
    if (filter->count >= DEFY_BATTERY_FILTER_MIN_SAMPLES &&
        now - filter->started_at >= DEFY_BATTERY_FILTER_MIN_SPAN_MS &&
        (!filter->valid || filter->millivolts[best] < filter->estimate_mv ||
         votes > 2u * held)) {
        filter->level = filter->levels[best];
        filter->estimate_mv = filter->millivolts[best];
        filter->valid = true;
    }
    return filter->valid ? filter->level : DEFY_BATTERY_LEVEL_UNAVAILABLE;
}

void defy_battery_filter_apply(struct defy_battery_filter *filter,
                               struct defy_battery_sample *sample, int64_t now) {
    struct defy_battery_reading reading;
    struct defy_battery_charger charger;
    uint8_t level = DEFY_BATTERY_LEVEL_UNAVAILABLE;
    bool charger_known =
        sample->words[DEFY_BATTERY_ANALOG_FORMAT] == DEFY_BATTERY_ANALOG_CHARGER_TAG &&
        !defy_battery_sample_charger(sample, &charger) && charger.status_valid;
    bool charger_idle = charger_known && !charger.boost &&
        charger.state == DEFY_BATTERY_CHARGE_READY &&
        (charger.fault == 0 || charger.fault == DEFY_BATTERY_CHARGER_FAULT_SLEEP);
    if (charger_idle && !defy_battery_sample_reading(sample, &reading)) {
        filter->invalid = 0;
        filter->charger_active = false;
        level = filter_reading(filter, &reading, now - sample->age_ms);
    } else if (charger_known && !charger_idle) {
        /* Charging, charged, boost or a fault: a real change, not a bad sample. */
        memset(filter, 0, sizeof(*filter));
        filter->charger_active = true;
    } else if (filter->invalid < DEFY_BATTERY_FILTER_INVALID_LIMIT &&
               ++filter->invalid == DEFY_BATTERY_FILTER_INVALID_LIMIT) {
        memset(filter, 0, sizeof(*filter));
        filter->invalid = DEFY_BATTERY_FILTER_INVALID_LIMIT;
    }
    /*
     * battery.c lays out every analog sample as DEFY_BATTERY_ANALOG_CHARGER_TAG:
     * the raw comparator reading and the charger registers, which the decoders
     * in battery/defy_battery_protocol.c read. Here it becomes
     * DEFY_BATTERY_ANALOG_FILTERED_TAG, with the estimate in the threshold
     * word's high byte. Only the filtered form leaves the radio.
     */
    if ((sample->status == DEFY_BATTERY_SAMPLE_ANALOG_OK ||
         sample->status == DEFY_BATTERY_SAMPLE_ANALOG_ERROR) &&
        sample->words[DEFY_BATTERY_ANALOG_FORMAT] == DEFY_BATTERY_ANALOG_CHARGER_TAG) {
        sample->words[DEFY_BATTERY_ANALOG_FORMAT] = DEFY_BATTERY_ANALOG_FILTERED_TAG;
        if (sample->status == DEFY_BATTERY_SAMPLE_ANALOG_OK) {
            sample->words[DEFY_BATTERY_ANALOG_THRESHOLD] =
                (sample->words[DEFY_BATTERY_ANALOG_THRESHOLD] & 0xffu) | (uint16_t)level << 8;
        }
    }
}

/*
 * While the charger is idle: 1 Hz while the history fills or a bad sample
 * awaits its retry, otherwise the settled interval.
 */
uint32_t defy_battery_filter_delay(const struct defy_battery_filter *filter) {
    if (filter->charger_active) {
        return DEFY_BATTERY_FILTER_CHARGER_INTERVAL_MS;
    }
    if ((filter->invalid > 0 && filter->invalid < DEFY_BATTERY_FILTER_INVALID_LIMIT) ||
        (filter->count > 0 && !filter->valid)) {
        return DEFY_BATTERY_FILTER_INTERVAL_MS;
    }
    return DEFY_BATTERY_FILTER_SETTLED_INTERVAL_MS;
}
```

## src/battery_filter.h
```c
/*
 * The radio's estimate of the battery level from comparator samples:
 * battery_filter.c.
 *
 * SPDX-License-Identifier: MIT
 */

#ifndef DEFY_RADIO_BATTERY_FILTER_H
#define DEFY_RADIO_BATTERY_FILTER_H

#include <dygma/defy_battery.h>

#define DEFY_BATTERY_FILTER_SAMPLES 60u
/* An estimate needs at least this many samples over at least this long. */
#define DEFY_BATTERY_FILTER_MIN_SAMPLES 5u
#define DEFY_BATTERY_FILTER_MIN_SPAN_MS 4000
#define DEFY_BATTERY_FILTER_INTERVAL_MS 1000
#define DEFY_BATTERY_FILTER_SETTLED_INTERVAL_MS 10000
#define DEFY_BATTERY_FILTER_CHARGER_INTERVAL_MS 5000
/* A longer gap between discharge samples restarts the history. */
#define DEFY_BATTERY_FILTER_GAP_MS (2 * DEFY_BATTERY_FILTER_SETTLED_INTERVAL_MS)
/* Consecutive unusable samples that clear the history. */
#define DEFY_BATTERY_FILTER_INVALID_LIMIT 3u

struct defy_battery_filter {
    uint16_t millivolts[DEFY_BATTERY_FILTER_SAMPLES];
    uint8_t levels[DEFY_BATTERY_FILTER_SAMPLES];
    uint8_t count;
    uint8_t next;
    uint8_t level;
    uint8_t invalid;
    uint16_t estimate_mv;
    bool valid;
    bool charger_active;
    int64_t started_at;
    int64_t sampled_at;
};

void defy_battery_filter_apply(struct defy_battery_filter *filter,
                               struct defy_battery_sample *sample, int64_t now);
uint32_t defy_battery_filter_delay(const struct defy_battery_filter *filter);

#endif
```

## src/battery_hci.c
```c
/*
 * The samples battery.c publishes, as vendor events for the host
 * (include/dygma/defy_battery_hci.h). One buffer holds the event: a sample
 * published while it waits to be read replaces any other waiting sample, and
 * goes out once the host has read the event before it. The age in a queued
 * event is brought up to date in the copy armed for each read, never in the
 * queued buffer.
 *
 * SPDX-License-Identifier: MIT
 */

#include <errno.h>

#include <zephyr/bluetooth/buf.h>
#include <zephyr/bluetooth/hci_types.h>
#include <zephyr/kernel.h>
#include <zephyr/net_buf.h>
#include <zephyr/sys/byteorder.h>

#include <dygma/defy_battery_hci.h>
#include <dygma/defy_hci_spi.h>

#include "battery.h"
#include "bridge.h"

NET_BUF_POOL_FIXED_DEFINE(battery_pool, 1,
                          BT_BUF_RESERVE + sizeof(struct bt_hci_evt_hdr) +
                              DEFY_BATTERY_HCI_PAYLOAD_SIZE,
                          sizeof(struct bt_buf_data), NULL);

static struct k_spinlock battery_lock;
static struct defy_battery_sample battery_latest;
static int64_t battery_latest_at;
static bool battery_pending;
static bool battery_stopped;
static uint32_t battery_queued_age;
static int64_t battery_queued_at;

static uint32_t battery_age(uint32_t age, int64_t since) {
    uint64_t elapsed = MAX(k_uptime_get() - since, 0);

    return MIN((uint64_t)age + elapsed, UINT32_MAX);
}

/* The event for the waiting sample, if there is one and the buffer is free. Called locked. */
static struct net_buf *take_locked(void) {
    if (!battery_pending || battery_stopped) {
        return NULL;
    }

    struct net_buf *buf = net_buf_alloc(&battery_pool, K_NO_WAIT);

    if (buf == NULL) {
        return NULL;
    }
    net_buf_reserve(buf, BT_BUF_RESERVE);
    bt_buf_set_type(buf, BT_BUF_EVT);
    net_buf_add_u8(buf, BT_HCI_EVT_VENDOR);
    net_buf_add_u8(buf, DEFY_BATTERY_HCI_PAYLOAD_SIZE);
    uint8_t *payload = net_buf_add(buf, DEFY_BATTERY_HCI_PAYLOAD_SIZE);
    struct defy_battery_sample sample = battery_latest;

    battery_queued_age = battery_latest.age_ms;
    battery_queued_at = battery_latest_at;
    sample.age_ms = battery_age(battery_queued_age, battery_queued_at);
    sys_put_le16(DEFY_HCI_SPI_EVT_BATTERY, payload);
    defy_battery_hci_encode(payload, &sample);
    battery_pending = false;
    return buf;
}

static void queue_waiting(void) {
    k_spinlock_key_t key = k_spin_lock(&battery_lock);
    struct net_buf *buf = take_locked();

    k_spin_unlock(&battery_lock, key);
    if (buf != NULL) {
        defy_radio_queue_for_host(buf, false);
    }
}

int defy_radio_battery_publish(const struct defy_battery_sample *sample) {
    if (!defy_battery_hci_sample_valid(sample)) {
        return -EINVAL;
    }

    k_spinlock_key_t key = k_spin_lock(&battery_lock);

    if (battery_stopped) {
        k_spin_unlock(&battery_lock, key);
        return -ESHUTDOWN;
    }
    battery_latest = *sample;
    battery_latest_at = k_uptime_get();
    battery_pending = true;
    k_spin_unlock(&battery_lock, key);
    queue_waiting();
    return 0;
}

void defy_radio_battery_hci_sent(void) { queue_waiting(); }

void defy_radio_battery_hci_power_off(void) {
    k_spinlock_key_t key = k_spin_lock(&battery_lock);

    battery_stopped = true;
    battery_pending = false;
    k_spin_unlock(&battery_lock, key);
}

void defy_radio_battery_hci_arm(const struct net_buf *buf, uint8_t *message) {
    if (net_buf_pool_get(buf->pool_id) != &battery_pool) {
        return;
    }

    k_spinlock_key_t key = k_spin_lock(&battery_lock);
    uint32_t age = battery_age(battery_queued_age, battery_queued_at);

    k_spin_unlock(&battery_lock, key);
    defy_battery_hci_set_age(&message[1 + sizeof(struct bt_hci_evt_hdr)], age);
}

uint8_t defy_radio_battery_hci_refresh(void) {
    k_spinlock_key_t key = k_spin_lock(&battery_lock);
    bool stopped = battery_stopped;

    k_spin_unlock(&battery_lock, key);
    return !stopped && defy_radio_battery_refresh() == 0 ? BT_HCI_ERR_SUCCESS
                                                         : BT_HCI_ERR_CMD_DISALLOWED;
}
```

## src/battery_trace.c
```c
/*
 * I2C diagnostics for the battery samples. Linked with
 * --wrap=nrfx_twim_init, it puts itself between the TWIM1 driver and its
 * event handler, to count the bus events of each read and keep the last one.
 * When a gauge read fails, the sample becomes an I2C diagnostic sample: the
 * register, the error and how long it took, the events, and the bus pins'
 * levels and configuration. After an address NACK, battery.c probes the
 * charger as well, and its result joins the sample.
 *
 * SPDX-License-Identifier: MIT
 */

#include <nrfx_twim.h>
#include <hal/nrf_gpio.h>
#include <zephyr/kernel.h>

#include <dygma/defy_wrap.h>

#include "battery_trace.h"

static struct k_spinlock trace_lock;
static nrfx_twim_evt_handler_t original_handler;
static uint8_t trace_count;
static uint16_t trace_event;

DEFY_WRAP_REAL(nrfx_twim_init);

static void trace_handler(nrfx_twim_evt_t const *event, void *context) {
    k_spinlock_key_t key = k_spin_lock(&trace_lock);
    trace_count = MIN((unsigned int)trace_count + 1, UINT8_MAX);
    trace_event = (uint8_t)event->type | (uint16_t)(uint8_t)event->xfer_desc.type << 8;
    nrfx_twim_evt_handler_t handler = original_handler;
    k_spin_unlock(&trace_lock, key);
    handler(event, context);
}

nrfx_err_t __wrap_nrfx_twim_init(nrfx_twim_t const *instance, nrfx_twim_config_t const *config,
                                nrfx_twim_evt_handler_t handler, void *context) {
    if (instance->p_twim != NRF_TWIM1 || handler == NULL) {
        return __real_nrfx_twim_init(instance, config, handler, context);
    }
    nrfx_err_t result = __real_nrfx_twim_init(instance, config, trace_handler, context);
    if (result == NRFX_SUCCESS) {
        k_spinlock_key_t key = k_spin_lock(&trace_lock);
        original_handler = handler;
        k_spin_unlock(&trace_lock, key);
    }
    return result;
}
DEFY_WRAP_CHECK(nrfx_twim_init);

void defy_battery_trace_begin(void) {
    k_spinlock_key_t key = k_spin_lock(&trace_lock);
    trace_count = 0;
    trace_event = DEFY_BATTERY_I2C_NO_EVENT;
    k_spin_unlock(&trace_lock, key);
}

void defy_battery_trace_error(struct defy_battery_sample *sample, uint8_t reg, int error,
                              uint32_t elapsed_us) {
    k_spinlock_key_t key = k_spin_lock(&trace_lock);
    uint8_t count = trace_count;
    uint16_t event = trace_event;
    uint32_t sda = NRF_TWIM1->PSEL.SDA;
    uint32_t scl = NRF_TWIM1->PSEL.SCL;
    uint32_t inputs = NRF_P0->IN;
    uint16_t pins = (sda & 31u) | (scl & 31u) << 5;
    uint16_t configuration = 0;
    if (sda & BIT(31)) {
        pins |= DEFY_BATTERY_I2C_SDA_DISCONNECTED;
    } else {
        pins |= inputs & BIT(sda & 31u) ? DEFY_BATTERY_I2C_SDA_HIGH : 0;
        configuration |= NRF_P0->PIN_CNF[sda & 31u] & 0xffu;
    }
    if (scl & BIT(31)) {
        pins |= DEFY_BATTERY_I2C_SCL_DISCONNECTED;
    } else {
        pins |= inputs & BIT(scl & 31u) ? DEFY_BATTERY_I2C_SCL_HIGH : 0;
        configuration |= (NRF_P0->PIN_CNF[scl & 31u] & 0xffu) << 8;
    }
    pins |= NRF_TWIM1->ENABLE ? DEFY_BATTERY_I2C_ENABLED : 0;
    k_spin_unlock(&trace_lock, key);
    sample->status = DEFY_BATTERY_SAMPLE_I2C_DIAGNOSTIC;
    sample->words[DEFY_BATTERY_I2C_TAG] = DEFY_BATTERY_I2C_DIAGNOSTIC_TAG;
    sample->words[DEFY_BATTERY_I2C_REGISTER_EVENTS] = reg | (uint16_t)count << 8;
    sample->words[DEFY_BATTERY_I2C_ERRNO] = (uint16_t)error;
    sample->words[DEFY_BATTERY_I2C_ELAPSED_LOW] = elapsed_us;
    sample->words[DEFY_BATTERY_I2C_ELAPSED_HIGH] = elapsed_us >> 16;
    sample->words[DEFY_BATTERY_I2C_EVENT_TYPE] = event;
    sample->words[DEFY_BATTERY_I2C_PINS] = pins;
    sample->words[DEFY_BATTERY_I2C_PIN_CNF_LOW8] = configuration;
}

bool defy_battery_trace_tx_address_nack(const struct defy_battery_sample *sample) {
    return sample->status == DEFY_BATTERY_SAMPLE_I2C_DIAGNOSTIC &&
           sample->words[DEFY_BATTERY_I2C_TAG] == DEFY_BATTERY_I2C_DIAGNOSTIC_TAG &&
           sample->words[DEFY_BATTERY_I2C_REGISTER_EVENTS] >> 8 &&
           sample->words[DEFY_BATTERY_I2C_EVENT_TYPE] ==
               (NRFX_TWIM_EVT_ADDRESS_NACK | NRFX_TWIM_XFER_TX << 8);
}

static uint16_t pack_trace(uint8_t count, uint16_t event) {
    if (event == DEFY_BATTERY_I2C_NO_EVENT) {
        return (uint16_t)count << 8 | DEFY_BATTERY_I2C_PACKED_NO_EVENT << 4 |
               DEFY_BATTERY_I2C_PACKED_NO_EVENT;
    }
    uint8_t type = MIN(event >> 8, DEFY_BATTERY_I2C_PACKED_UNKNOWN);
    uint8_t kind = MIN(event & 0xff, DEFY_BATTERY_I2C_PACKED_UNKNOWN);
    return (uint16_t)count << 8 | type << 4 | kind;
}

static uint8_t elapsed_ms(uint32_t elapsed_us) {
    return MIN(elapsed_us / 1000u + (elapsed_us % 1000u != 0), UINT8_MAX);
}

void defy_battery_trace_charger(struct defy_battery_sample *sample, uint8_t reg, int error,
                               uint8_t value, uint32_t elapsed_us) {
    k_spinlock_key_t key = k_spin_lock(&trace_lock);
    uint16_t charger_trace = pack_trace(trace_count, trace_event);
    k_spin_unlock(&trace_lock, key);
    uint16_t gauge_register_events = sample->words[DEFY_BATTERY_I2C_REGISTER_EVENTS];
    uint16_t gauge_errno = sample->words[DEFY_BATTERY_I2C_ERRNO];
    uint16_t gauge_trace = pack_trace(gauge_register_events >> 8,
                                     sample->words[DEFY_BATTERY_I2C_EVENT_TYPE]);
    uint32_t gauge_us = sample->words[DEFY_BATTERY_I2C_ELAPSED_LOW] |
                        (uint32_t)sample->words[DEFY_BATTERY_I2C_ELAPSED_HIGH] << 16;
    sample->words[DEFY_BATTERY_I2C_CHARGER_FORMAT] = DEFY_BATTERY_I2C_CHARGER_TAG;
    sample->words[DEFY_BATTERY_I2C_PROBE_REGISTERS] =
        (gauge_register_events & 0xff) | (uint16_t)reg << 8;
    sample->words[DEFY_BATTERY_I2C_GAUGE_ERRNO] = gauge_errno;
    sample->words[DEFY_BATTERY_I2C_GAUGE_TRACE] = gauge_trace;
    sample->words[DEFY_BATTERY_I2C_CHARGER_ERRNO] = error;
    sample->words[DEFY_BATTERY_I2C_CHARGER_VALUE] = error ? DEFY_BATTERY_I2C_NO_VALUE : value;
    sample->words[DEFY_BATTERY_I2C_CHARGER_TRACE] = charger_trace;
    sample->words[DEFY_BATTERY_I2C_PROBE_ELAPSED_MS] =
        elapsed_ms(gauge_us) | (uint16_t)elapsed_ms(elapsed_us) << 8;
}
```

## src/battery_trace.h
```c
/*
 * I2C diagnostics for the battery samples: battery_trace.c.
 *
 * SPDX-License-Identifier: MIT
 */

#ifndef DEFY_RADIO_BATTERY_TRACE_H
#define DEFY_RADIO_BATTERY_TRACE_H

#include <dygma/defy_battery.h>

void defy_battery_trace_begin(void);
void defy_battery_trace_error(struct defy_battery_sample *sample, uint8_t reg, int error,
                              uint32_t elapsed_us);
bool defy_battery_trace_tx_address_nack(const struct defy_battery_sample *sample);
void defy_battery_trace_charger(struct defy_battery_sample *sample, uint8_t reg, int error,
                               uint8_t value, uint32_t elapsed_us);

#endif
```

## src/boot.h
```c
/*
 * Quiescing the SPI slave rf_bootloader leaves enabled: boot.c, called from
 * the reset hook in startup.c.
 *
 * SPDX-License-Identifier: MIT
 */

#ifndef DEFY_RADIO_BOOT_H
#define DEFY_RADIO_BOOT_H

#include <stdbool.h>

/* How long chip select has to go idle. */
#define DEFY_RADIO_BOOT_QUIESCE_TIMEOUT_US 20000u

/*
 * Waits for chip select to be idle, takes the SPIS semaphore and disables the
 * SPIS, calling keep_alive, which may be NULL, once a millisecond meanwhile.
 * True if the SPIS is disabled, false if it could not be disabled safely.
 */
bool defy_radio_boot_quiesce_spis(void (*keep_alive)(void));

#endif
```

## src/boot_io.h
```c
/*
 * Register access for boot.c. tests/host/defy_radio_boot replaces this file
 * with one that fakes the registers.
 *
 * SPDX-License-Identifier: MIT
 */

#ifndef DEFY_RADIO_BOOT_IO_H
#define DEFY_RADIO_BOOT_IO_H

#include <stdint.h>

static inline uint32_t defy_radio_boot_read(uintptr_t address) {
    return *(volatile uint32_t *)address;
}

static inline void defy_radio_boot_write(uintptr_t address, uint32_t value) {
    *(volatile uint32_t *)address = value;
}

#endif
```
